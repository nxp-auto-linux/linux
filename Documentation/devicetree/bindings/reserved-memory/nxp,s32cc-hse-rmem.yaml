## Documentation/devicetree/bindings/reserved-memory/nxp,s32cc-hse-rmem.yaml
```yaml
# SPDX-License-Identifier: (GPL-2.0-only OR BSD-2-Clause)
%YAML 1.2
---
$id: http://devicetree.org/schemas/reserved-memory/nxp,s32cc-hse-rmem.yaml#
$schema: http://devicetree.org/meta-schemas/core.yaml#

title: NXP Hardware Security Engine Reserved Memory

maintainers:
  - Vlad Pelin <vlad.pelin@nxp.com>

description: |
  - Reserved Memory required for NXP Hardware Security Engine

properties:
  compatible:
    const: nxp,s32cc-hse-rmem
    description: Standard property. Must include "nxp,s32cc-hse-rmem".

  reg:
    description: Standard property. Should specify the physical address and size
                 of reserved memory region

  no-map:
    $ref: /schemas/types.yaml#/definitions/flag
    description:
      Avoid creating a virtual mapping of the region as part of the OS'
      standard mapping of system memory.

additionalProperties: false

required:
  - compatible
  - reg
  - no-map

examples:
  - |
    reserved-memory {
        #address-cells = <2>;
        #size-cells = <2>;

        hse_shm@84000000 {
            compatible = "nxp,s32cc-hse-rmem";
            reg = <0x0 0x84000000 0x0 0x80000>;
            no-map;
        };
    };
```

## Documentation/devicetree/bindings/reset/fsl,s32v234-mc_rgm.yaml
```yaml
# SPDX-License-Identifier: GPL-2.0
%YAML 1.2
---

title: Reset Generation Module (MC_RGM)

maintainers:
  - Ciprian Marian Costea <ciprianmarian.costea@nxp.com>

description: |
  - The reset generation module (MC_RGM) centralizes the different
  reset sources and manages the reset sequence of the chip. It
  provides a register interface and the reset sequencer. Various
  registers are available to monitor and control the chip reset
  sequence. The reset sequencer is a state machine which controls
  the different phases (PHASE0, PHASE1, PHASE2, PHASE3, and IDLE)
  of the reset sequence and controls the reset signals generated
  in the system.

properties:
  compatible:
    const:
      - fsl,s32v234-mc_rgm

  reg:
    description: |
      Should be register base and length as documented in the
      datasheet.

required:
  - compatible
  - reg

additionalProperties: false

examples:
  - |
    mc_rgm: mc_rgm@40048000 {
      compatible = "fsl,s32v234-mc_rgm";
      reg = <0x0 0x40048000 0x0 0x1000>;
    };
...
```

## Documentation/devicetree/bindings/rtc/fsl,s32gen1-rtc.yaml
```yaml
# SPDX-License-Identifier: (GPL-2.0 OR BSD-2-Clause)
%YAML 1.2
---
$id: http://devicetree.org/schemas/rtc/nxp,s32cc-rtc.yaml#
$schema: http://devicetree.org/meta-schemas/core.yaml#

title: NXP S32GEN1 Real Time Clock (RTC)

maintainers:
  - Bogdan Hamciuc <bogdan.hamciuc@nxp.com>

properties:
  compatible:
    const: nxp,s32cc-rtc

  reg:
    description:
      The size of the memory address space of the device.

  interrupts:
    description:
      Specifies the Real Time Clock interrupts id.

  nxp,clksel:
    description:
      Input clock selector; choose between 0-SIRC and 2-FIRC

  nxp,dividers:
    description:
      An array of two u32 elements, the former encoding DIV512,
      the latter encoding DIV32. These are dividers that can be enabled
      individually, or cascaded. Use 0 to disable the respective divider,
      and 1 to enable it.

  clocks:
    items:
      - description: Registers Clock
      - description: FIRC frequency
      - description: SIRC frequency

  clock-names:
    items:
      - const: ipg
      - const: firc
      - const: sirc

required:
  - clock-names
  - clocks
  - compatible
  - interrupts
  - nxp,clksel
  - nxp,dividers
  - reg

additionalProperties: false

examples:
  - |
    #define RTC_FIRC_CLKSEL	2
    #define RTC_SIRC_CLKSEL	0
    #define S32GEN1_SCMI_CLK_RTC_REG
    #define S32GEN1_SCMI_CLK_RTC_SIRC
    #define S32GEN1_SCMI_CLK_RTC_FIRC
    rtc0: rtc@40060000 {
        compatible = "nxp,s32cc-rtc";
        reg = <0x40060000 0x1000>;
        interrupts = <0 121 4>;
        clocks = <&clks S32GEN1_SCMI_CLK_RTC_REG>,
                 <&clks S32GEN1_SCMI_CLK_RTC_SIRC>,
                 <&clks S32GEN1_SCMI_CLK_RTC_FIRC>;
        clock-names = "ipg", "sirc", "firc";
        nxp,clksel = <RTC_FIRC_CLKSEL>;
        nxp,dividers = <1 0>;
    };
```

## Documentation/devicetree/bindings/rtc/nxp,s32cc-mscm.yaml
```yaml
# SPDX-License-Identifier: (GPL-2.0-only OR BSD-2-Clause)
%YAML 1.2
---
$id: http://devicetree.org/schemas/interrupt-controller/nxp,s32cc-mscm.yaml#
$schema: http://devicetree.org/meta-schemas/core.yaml#

title: NXP S32CC Miscellaneous System Control Module (MSCM)

maintainers:
  - Hoang Nguyen Le <hoang.nguyenle@nxp.com>

description: |
  Miscellaneous System Control Module (MSCM) for S32CC NPIs

properties:
  compatible:
    enum:
      - nxp,s32cc-mscm

  reg:
    maxItems: 1

  interrupts:
    maxItems: 12

required:
  - compatible
  - reg
  - interrupts

additionalProperties: false

examples:
  - |
    #include <dt-bindings/interrupt-controller/arm-gic.h>
    #include <dt-bindings/interrupt-controller/irq.h>

	mscm0: mscm@40198000 {
			compatible = "nxp,s32cc-mscm";
			reg = <0x0 0x40198000 0x0 0x1000>;
			/* CPU2CPU interrupts */
			interrupts = <GIC_SPI 1 IRQ_TYPE_LEVEL_HIGH>,
						 <GIC_SPI 2 IRQ_TYPE_LEVEL_HIGH>,
						 <GIC_SPI 3 IRQ_TYPE_LEVEL_HIGH>,
						 <GIC_SPI 22 IRQ_TYPE_LEVEL_HIGH>,
						 <GIC_SPI 23 IRQ_TYPE_LEVEL_HIGH>,
						 <GIC_SPI 68 IRQ_TYPE_LEVEL_HIGH>,
						 <GIC_SPI 69 IRQ_TYPE_LEVEL_HIGH>,
						 <GIC_SPI 164 IRQ_TYPE_LEVEL_HIGH>,
						 <GIC_SPI 165 IRQ_TYPE_LEVEL_HIGH>,
						 <GIC_SPI 166 IRQ_TYPE_LEVEL_HIGH>,
						 <GIC_SPI 167 IRQ_TYPE_LEVEL_HIGH>,
						 <GIC_SPI 168 IRQ_TYPE_LEVEL_HIGH>;
		};
```

## Documentation/devicetree/bindings/serial/fsl,s32-linflexuart.txt
```
* Freescale LINFlexD UART

The LINFlexD controller implements several LIN protocol versions, as well as
support for full-duplex UART communication through 8-bit and 9-bit frames. The
Linflex UART driver enables operation only in UART mode.

See chapter 47 ("LINFlexD") in the reference manual[1].

Required properties:
- compatible :
  - "fsl,s32-linflexuart" for linflex configured in uart mode which
  is compatible with the one integrated on S32V234 SoC
- reg : Address and length of the register set for the device
- interrupts : Should contain uart interrupt
- clocks : phandle + clock specifier pairs, one for each entry in clock-names
- clock-names : should contain: "lin" - the uart clock

Example:
#include <dt-bindings/clock/s32gen1-scmi-clock.h>

uart0: serial@401C8000 {
	compatible = "fsl,s32-linflexuart";
	reg = <0x401C8000 0x3000>;
	interrupts = <0 82 1>;
	clocks = <&clks S32GEN1_SCMI_CLK_LINFLEX_LIN>,
		 <&clks S32GEN1_SCMI_CLK_LINFLEX_XBAR>;
	clock-names = "lin", "ipg";
	dmas = <&edma0 0 4>,
	       <&edma0 0 3>;
	dma-names = "rx", "tx";
};

- |
#include <dt-bindings/clock/s32v234-clock.h>

uart1: serial@40053000 {
	compatible = "fsl,s32-linflexuart";
	reg = <0x40053000 0x1000>;
	interrupts = <0 59 1>;
	clocks = <&clks S32V234_CLK_LIN0>,
		 <&clks S32V234_CLK_LIN0_IPG>;
	clock-names = "lin", "ipg";
	dmas = <&edma 0 20>,
	       <&edma 0 19>;
	dma-names = "rx", "tx";
	status = "disabled";
};

[1] https://www.nxp.com/webapp/Download?colCode=S32V234RM
```

## Documentation/devicetree/bindings/serial/fsl,s32-linflexuart.yaml
```yaml
# SPDX-License-Identifier: (GPL-2.0-only OR BSD-2-Clause)
%YAML 1.2
---
$id: http://devicetree.org/schemas/serial/fsl,s32-linflexuart.yaml#
$schema: http://devicetree.org/meta-schemas/core.yaml#

title: Freescale LINFlexD UART

description: |
  The LINFlexD controller implements several LIN protocol versions, as well
  as support for full-duplex UART communication through 8-bit and 9-bit
  frames. See chapter 47 ("LINFlexD") in the reference manual
  https://www.nxp.com/webapp/Download?colCode=S32V234RM.

  Linflex modules tied to LLCE work only in interrupt mode. Moreover,
  the channels share the same interrupt so LLCE mailbox is used as the
  interrupt parent. The nodes should be defined as a child of LLCE node
  (see llce_uart0 as an example).

maintainers:
  - Chester Lin <clin@suse.com>

allOf:
  - $ref: "serial.yaml"

properties:
  compatible:
    oneOf:
      - enum:
          - nxp,s32cc-linflexuart
          - fsl,s32v234-linflexuart

  reg:
    maxItems: 1

  interrupts:
    maxItems: 1

  interrupts-extended:
    description:
      In LLCE LIN case, the same interrupt is used for all LIN
      channels and LLCE mailbox is the interrupt controller which
      will handle it. Each Linflex node should specify as interrupt,
      a unique number between 0 and max LLCE LIN channels (see llce_uart0
      as an example).
    maxItems: 1

  clocks:
    items:
      - description: lin clock
      - description: ipg clock

  clock-names:
    items:
      - const: lin
      - const: ipg

  dmas:
    items:
      - description: DMA controller phandle and request line for RX
      - description: DMA controller phandle and request line for TX

  dma-names:
    items:
      - const: rx
      - const: tx

  rs485-rts-active-low: true
  linux,rs485-enabled-at-boot-time: true

required:
  - compatible
  - reg
  - clocks
  - clock-names

oneOf:
  - required:
      - interrupts
  - required:
      - interrupts-extended

unevaluatedProperties: false

examples:
  - |
    #include <dt-bindings/clock/s32cc-scmi-clock.h>

    serial@401c8000 {
        compatible = "nxp,s32cc-linflexuart";
        reg = <0x401C8000 0x3000>;
        interrupts = <0 82 1>;
        clocks = <&clks S32CC_SCMI_CLK_LINFLEX_LIN>,
                 <&clks S32CC_SCMI_CLK_LINFLEX_XBAR>;
        clock-names = "lin", "ipg";
        dmas = <&edma0 0 4>,
               <&edma0 0 3>;
        dma-names = "rx", "tx";
    };

  - |
    #define S32V234_CLK_LIN0 131
    #define S32V234_CLK_LIN0_IPG 132

    serial@40053000 {
        compatible = "fsl,s32v234-linflexuart";
        reg = <0x40053000 0x1000>;
        interrupts = <0 59 4>;
        clocks = <&clks S32V234_CLK_LIN0>,
                 <&clks S32V234_CLK_LIN0_IPG>;
        clock-names = "lin", "ipg";
        dmas = <&edma 0 20>,
               <&edma 0 19>;
        dma-names = "rx", "tx";
    };

  - |
    #include <dt-bindings/clock/s32cc-scmi-clock.h>

    #define LLCE_MB_LINFLEXD_IRQ_0 0x0

    llce_uart0: serial@43c08000 {
       compatible = "nxp,s32cc-linflexuart";
       reg = <0x7 0x0 0x0 0x400>;
       reg-names = "llce_uart_base";
       clocks = <&clks S32CC_SCMI_CLK_LINFLEX_LIN>,
                    <&clks S32CC_SCMI_CLK_LINFLEX_XBAR>;
       clock-names = "lin", "ipg";
       pinctrl-0 = <&llce_uart0_pins>;
       pinctrl-names = "default";
       interrupts-extended = <&llce_mb LLCE_MB_LINFLEXD_IRQ_0>;
    };
```

## Documentation/devicetree/bindings/serial/fsl-linflexuart.yaml
```yaml
# SPDX-License-Identifier: (GPL-2.0-only OR BSD-2-Clause)
%YAML 1.2
---
$id: http://devicetree.org/schemas/serial/fsl-linflexuart.yaml#
$schema: http://devicetree.org/meta-schemas/core.yaml#

title: Freescale LINFlexD UART

maintainers:
  - Larisa Grigore <larisa.grigore@nxp.com>

allOf:
  - $ref: "rs485.yaml"

properties:
  compatible:
    oneOf:
      - enum:
          - nxp,s32cc-linflexuart

  reg:
    maxItems: 1

  interrupts:
    maxItems: 1

  clocks:
    items:
      - description: lin clock
      - description: ipg clock
    minItems: 1
    maxItems: 2

  clock-names:
    items:
      - const: lin
      - const: ipg
    minItems: 1
    maxItems: 2

  dmas:
    items:
      - description: DMA controller phandle and request line for RX
      - description: DMA controller phandle and request line for TX

  dma-names:
    items:
      - const: rx
      - const: tx

  rs485-rts-active-low: true
  linux,rs485-enabled-at-boot-time: true

required:
  - compatible
  - reg
  - interrupts
  - clocks
  - clock-names

unevaluatedProperties: false

examples:
  - |
    #include <dt-bindings/clock/s32gen1-scmi-clock.h>

    uart0: serial@401C8000 {
        compatible = "nxp,s32cc-linflexuart";
        reg = <0x401C8000 0x3000>;
        interrupts = <0 82 1>;
        clocks = <&clks S32GEN1_SCMI_CLK_LINFLEX_LIN>,
                 <&clks S32GEN1_SCMI_CLK_LINFLEX_XBAR>;
        clock-names = "lin", "ipg";
        dmas = <&edma0 0 4>,
               <&edma0 0 3>;
        dma-names = "rx", "tx";
    };
```

## Documentation/devicetree/bindings/spi/spi-fsl-lpspi.yaml
```yaml
# SPDX-License-Identifier: (GPL-2.0-only OR BSD-2-Clause)
%YAML 1.2
---
$id: http://devicetree.org/schemas/spi/spi-fsl-lpspi.yaml#
$schema: http://devicetree.org/meta-schemas/core.yaml#

title: Freescale Low Power SPI (LPSPI) for i.MX

maintainers:
  - Anson Huang <Anson.Huang@nxp.com>

allOf:
  - $ref: "/schemas/spi/spi-controller.yaml#"

properties:
  compatible:
    enum:
      - fsl,imx7ulp-spi
      - fsl,imx8qxp-spi
      - nxp,s32g-lpspi

  reg:
    maxItems: 1

  interrupts:
    maxItems: 1

  clocks:
    items:
      - description: SoC SPI per clock
      - description: SoC SPI ipg clock

  clock-names:
    items:
      - const: per
      - const: ipg

  fsl,spi-only-use-cs1-sel:
    description:
      spi common code does not support use of CS signals discontinuously.
      i.MX8DXL-EVK board only uses CS1 without using CS0. Therefore, add
      this property to re-config the chipselect value in the LPSPI driver.
    type: boolean

  nxp,reset-at-underrun:
    description:
      In S32G3 case, TX FIFO pointers are corrupted when a transmit FIFO
      underrun occurs in slave mode (ERR051588). The workaround is to reset
      the TX FIFO before writing any new data.
    type: boolean

  nxp,lpspi-slave-no-pin-swap:
    description:
      This property is relevant for LPSPI target mode. When set, SIN is used
      for input data and SOUT is used for output data. Otherwise, SOUT is used
      for input data and SIN is used for output data.
    type: boolean

  pinctrl-0:
    description:
      A phandle to the default pinctrl state.

  pinctrl-names:
    const: default
    description:
      A pinctrl state named "default" must be defined.

required:
  - compatible
  - reg
  - clocks
  - clock-names

oneOf:
  - required:
      - interrupts
  - required:
      - interrupts-extended

unevaluatedProperties: false

examples:
  - |
    #include <dt-bindings/clock/imx7ulp-clock.h>
    #include <dt-bindings/interrupt-controller/arm-gic.h>

    spi@40290000 {
        compatible = "fsl,imx7ulp-spi";
        reg = <0x40290000 0x10000>;
        interrupt-parent = <&intc>;
        interrupts = <GIC_SPI 28 IRQ_TYPE_LEVEL_HIGH>;
        clocks = <&clks IMX7ULP_CLK_LPSPI2>,
                 <&clks IMX7ULP_CLK_DUMMY>;
        clock-names = "per", "ipg";
        spi-slave;
        fsl,spi-only-use-cs1-sel;
    };
  - |
    #include <dt-bindings/clock/s32g-scmi-clock.h>
    #include <dt-bindings/mailbox/nxp-llce-mb.h>

    llce_spi2: spi@43c02000 {
        compatible = "nxp,s32g-lpspi";
        reg = <0x14 0x0 0x0 0x1000>;
        clocks = <&clks S32G_SCMI_CLK_LLCE_PER>,
                 <&clks S32G_SCMI_CLK_LLCE_SYS>;
        clock-names = "per", "ipg";
        pinctrl-0 = <&lpspi2_pins>;
        pinctrl-names = "default";
        interrupts-extended = <&llce_mb LLCE_MB_LPSPI_IRQ_2>;
        nxp,lpspi-slave-no-pin-swap;
    };
```
