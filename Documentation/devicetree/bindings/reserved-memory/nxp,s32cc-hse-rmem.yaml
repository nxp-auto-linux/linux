## Documentation/devicetree/bindings/thermal/qoriq-thermal.yaml
```yaml
# SPDX-License-Identifier: (GPL-2.0-only OR BSD-2-Clause)
%YAML 1.2
---
$id: http://devicetree.org/schemas/thermal/qoriq-thermal.yaml#
$schema: http://devicetree.org/meta-schemas/core.yaml#

title: Thermal Monitoring Unit (TMU) on Freescale QorIQ SoCs

maintainers:
  - Anson Huang <Anson.Huang@nxp.com>

properties:
  compatible:
    description: |
      The version of the device is determined by the TMU IP Block Revision
      Register (IPBRR0) at offset 0x0BF8.
      Table of correspondences between IPBRR0 values and example chips:
            Value           Device
            ----------      -----
            0x01900102      T1040
    enum:
      - fsl,qoriq-tmu
      - fsl,imx8mq-tmu
      - nxp,s32cc-tmu

  reg:
    maxItems: 1

  interrupts:
    description: |
      TMU can monitor only one thermal zone using interrupts. For the rest of
      them, polling should be enabled.
    maxItems: 1

  fsl,tmu-range:
    $ref: '/schemas/types.yaml#/definitions/uint32-array'
    description: |
      The values to be programmed into TTRnCR, as specified by the SoC
      reference manual. The first cell is TTR0CR, the second is TTR1CR, etc.
    maxItems: 4

  fsl,tmu-calibration:
    $ref: '/schemas/types.yaml#/definitions/uint32-matrix'
    description: |
      A list of cell pairs containing temperature calibration data, as
      specified by the SoC reference manual. The first cell of each pair
      is the value to be written to TTCFGR, and the second is the value
      to be written to TSCFGR.

      On S32CC SoCs, this represents a list of 3-tuples where each tuple
      contains the value written in TTCFGR, the second is the value for
      TSCFGR and the last means an adjustment mask. This mask will be
      applied to the nvmem cell referenced via nvmem-cells to obtain an
      adjustment value for calibration points.
    minItems: 1
    maxItems: 64

  little-endian:
    description: |
      boolean, if present, the TMU registers are little endian. If absent,
      the default is big endian.
    type: boolean

  tmu-alpf:
    description: |
      It is used by the TMU for the average temperature computation.
      If present, it will replace the ALPF default value used in the driver
      (0.125). The average temperature is calculated using the formula:
      ALPF x Current_Temp + (1 - ALPF) x Average_Temp.
      The property is read only in TMU version 2 case.

  tmu-rate-filter:
    description: |
      TMU is reporting sometimes large errors in temperature measurement,
      for example, the temperature will go up by 40 degrees on one sample
      and then down 40 degrees on the next sample.
      This property is used to filter out the erroneous measurements and should
      contain the maximum acceptable difference between two consecutive TMU
      samples. The workaround applies only for the site monitored with IRQ and
      only for the immediate temperature. The average temperature will be still
      computed based on the erroneous value.

  clocks:
    maxItems: 1

  "#thermal-sensor-cells":
    const: 1

  nvmem-cells:
    maxItems: 1
    description:
      phandle to the temperature calibration fuse cells

  nvmem-cell-names:
    items:
      - const: tmu_fuse_val

required:
  - compatible
  - reg
  - interrupts
  - fsl,tmu-range
  - fsl,tmu-calibration
  - '#thermal-sensor-cells'

allOf:
  - if:
      properties:
        compatible:
          const: nxp,s32cc-tmu
    then:
      properties:
        fsl,tmu-calibration:
          items:
            items:
              - description: value for TTCFGR
              - description: value for TSCFGR
              - description: nvmem cell mask
      required:
        - nvmem-cell-names
        - nvmem-cells
    else:
      properties:
        fsl,tmu-calibration:
          items:
            items:
              - description: value for TTCFGR
              - description: value for TSCFGR

additionalProperties: false

examples:
  - |
    tmu@f0000 {
        compatible = "fsl,qoriq-tmu";
        reg = <0xf0000 0x1000>;
        interrupts = <18 2 0 0>;
        fsl,tmu-range = <0x000a0000 0x00090026 0x0008004a 0x0001006a>;
        fsl,tmu-calibration = <0x00000000 0x00000025>,
                              <0x00000001 0x00000028>,
                              <0x00000002 0x0000002d>,
                              <0x00000003 0x00000031>,
                              <0x00000004 0x00000036>,
                              <0x00000005 0x0000003a>,
                              <0x00000006 0x00000040>,
                              <0x00000007 0x00000044>,
                              <0x00000008 0x0000004a>,
                              <0x00000009 0x0000004f>,
                              <0x0000000a 0x00000054>,
                              <0x00010000 0x0000000d>,
                              <0x00010001 0x00000013>,
                              <0x00010002 0x00000019>,
                              <0x00010003 0x0000001f>,
                              <0x00010004 0x00000025>,
                              <0x00010005 0x0000002d>,
                              <0x00010006 0x00000033>,
                              <0x00010007 0x00000043>,
                              <0x00010008 0x0000004b>,
                              <0x00010009 0x00000053>,
                              <0x00020000 0x00000010>,
                              <0x00020001 0x00000017>,
                              <0x00020002 0x0000001f>,
                              <0x00020003 0x00000029>,
                              <0x00020004 0x00000031>,
                              <0x00020005 0x0000003c>,
                              <0x00020006 0x00000042>,
                              <0x00020007 0x0000004d>,
                              <0x00020008 0x00000056>,
                              <0x00030000 0x00000012>,
                              <0x00030001 0x0000001d>;
        #thermal-sensor-cells = <1>;
    };

  - |
    #include <dt-bindings/interrupt-controller/arm-gic.h>
    #include <dt-bindings/clock/s32cc-scmi-clock.h>
    #include <dt-bindings/thermal/qoriq_thermal.h>

    tmu@400a8000 {
        compatible = "nxp,s32cc-tmu";
        reg = <0x0 0x400a8000 0x0 0x3000>;
        clocks = <&clks S32CC_SCMI_CLK_TMU_MODULE>;
        nvmem-cell-names = "tmu_fuse_val";
        nvmem-cells = <&tmu_fuse_val>;
        fsl,tmu-range = <0xe9 0x101 0x13a 0x18e>;
        fsl,tmu-calibration = <0 0x2c  0x7c0>,
                              <1 0x59  0x0>,
                              <2 0xc6  0x0>,
                              <3 0x167 0x1f>;
        interrupts = <GIC_SPI 120 IRQ_TYPE_LEVEL_HIGH>;
        #thermal-sensor-cells = <1>;
        tmu-alpf = <QORIQ_TMR_ALPF_0_125>;
        status = "okay";
    };
```

## Documentation/devicetree/bindings/thermal/s32-thermal.yaml
```yaml
# SPDX-License-Identifier: (GPL-2.0-only OR BSD-2-Clause)
%YAML 1.2
---

$id: http://devicetree.org/schemas/thermal/s32-thermal.yaml#
$schema: http://devicetree.org/meta-schemas/core.yaml#

title: Temperature sensor driver for NXP s32cc SoCs

maintainers:
  - Andrei Cherechesu <andrei.cherechesu@nxp.com>

description: |
  Support for Temperature Monitoring Unit (TMU) found on NXP S32CC
  SoCs. It supports reporting the immediate and average temperature
  in a manner compatible with lm-sensors

properties:
  compatible:
    enum:
      - nxp,s32cc-tmu

  reg:
    description:
      Address range of the TMU registers

  clocks:
    description: |
      One entry, the clock for the TMU device

  clock-names:
    description: tsens

required:
  - compatible
  - reg
  - clocks
  - clock-names

additionalProperties: false

examples:
  - |
    tmu: tmu@400a8000 {
      compatible = "nxp,s32cc-tmu";
      reg = <0x0 0x400a8000 0x0 0x3000>,
          <0x0 0x400a4200 0x0 0x1fc>;
      status = "okay";
    };
...
```

## Documentation/devicetree/bindings/watchdog/nxp-s32cc-wdt.yaml
```yaml
# SPDX-License-Identifier: (GPL-2.0 OR BSD-2-Clause)
%YAML 1.2
---
$id: http://devicetree.org/schemas/watchdog/nxp-s32cc-wdt.yaml#
$schema: http://devicetree.org/meta-schemas/core.yaml#

title: Freescale S32CC Watchdog Timer (WDT) Controller

maintainers:
  - Gilles Talis <gilles.talis@freescale.com>

allOf:
  - $ref: "watchdog.yaml#"

properties:
  compatible:
    enum:
      - nxp,s32cc-wdt

  reg:
    maxItems: 1

  clocks:
    maxItems: 1

  clock-names:
    const: swt

  status:
    enum:
      - okay
      - disabled

required:
  - compatible
  - reg
  - clocks
  - clock-names
  - status

additionalProperties: false

examples:
  - |
    #include <dt-bindings/clock/s32cc-scmi-clock.h>

    watchdog@40200000 {
        compatible = "nxp,s32cc-wdt";
        reg = <0x40200000 0x1000>;
        clocks = <&clks S32CC_SCMI_CLK_SWT_COUNTER>;
        clock-names = "swt";
        status = "disabled";
    };

...
```

## arch/arm64/configs/s32cc_emu_defconfig
```kconfig
CONFIG_SYSVIPC=y
CONFIG_NO_HZ_IDLE=y
CONFIG_HIGH_RES_TIMERS=y
CONFIG_PREEMPT=y
CONFIG_BSD_PROCESS_ACCT=y
CONFIG_BSD_PROCESS_ACCT_V3=y
CONFIG_IKCONFIG=y
CONFIG_IKCONFIG_PROC=y
CONFIG_LOG_BUF_SHIFT=16
CONFIG_BLK_DEV_INITRD=y
# CONFIG_RD_BZIP2 is not set
# CONFIG_RD_LZMA is not set
# CONFIG_RD_XZ is not set
# CONFIG_RD_LZO is not set
# CONFIG_RD_LZ4 is not set
CONFIG_ARCH_NXP=y
CONFIG_ARCH_S32=y
CONFIG_ARCH_VEXPRESS=y
CONFIG_S32CC_EMULATOR=y
# CONFIG_CAVIUM_ERRATUM_22375 is not set
# CONFIG_CAVIUM_ERRATUM_23154 is not set
# CONFIG_CAVIUM_ERRATUM_27456 is not set
# CONFIG_CAVIUM_ERRATUM_30115 is not set
# CONFIG_QCOM_FALKOR_ERRATUM_1003 is not set
# CONFIG_QCOM_FALKOR_ERRATUM_1009 is not set
# CONFIG_QCOM_QDF2400_ERRATUM_0065 is not set
# CONFIG_QCOM_FALKOR_ERRATUM_E1041 is not set
CONFIG_SCHED_MC=y
CONFIG_SCHED_SMT=y
CONFIG_NR_CPUS=8
CONFIG_CMDLINE="console=ttyLF1"
# CONFIG_EFI is not set
CONFIG_JUMP_LABEL=y
# CONFIG_COMPAT_BRK is not set
CONFIG_DEFAULT_MMAP_MIN_ADDR=32768
CONFIG_DEVTMPFS=y
CONFIG_DEVTMPFS_MOUNT=y
CONFIG_INPUT_EVDEV=y
# CONFIG_INPUT_MOUSE is not set
CONFIG_INPUT_MISC=y
CONFIG_INPUT_UINPUT=y
CONFIG_SERIO_AMBAKMI=y
CONFIG_VT_HW_CONSOLE_BINDING=y
CONFIG_LEGACY_PTY_COUNT=1
CONFIG_SERIAL_AMBA_PL011=y
CONFIG_SERIAL_AMBA_PL011_CONSOLE=y
CONFIG_SERIAL_FSL_LINFLEXUART=y
CONFIG_SERIAL_FSL_LINFLEXUART_CONSOLE=y
CONFIG_DMADEVICES=y
CONFIG_FSL_EDMA=y
# CONFIG_IOMMU_SUPPORT is not set
CONFIG_HUGETLBFS=y
CONFIG_PRINTK_TIME=y
CONFIG_DEBUG_FS=y
# CONFIG_RUNTIME_TESTING_MENU is not set
```

## drivers/crypto/hse/Kconfig
```kconfig
# SPDX-License-Identifier: BSD-3-Clause

config CRYPTO_DEV_NXP_HSE
	tristate "Support for NXP HSE cryptographic engine"
	depends on SOC_S32CC
	default m
	help
	  Enables crypto driver support for NXP Hardware Security Engine (HSE).

choice
	prompt "Messaging Unit Interface"
	depends on CRYPTO_DEV_NXP_HSE
	default CRYPTO_DEV_NXP_HSE_MU0
	help
	  Configures the Messaging Unit instance reserved for the crypto driver.

config CRYPTO_DEV_NXP_HSE_MU0
	bool "MU0"
config CRYPTO_DEV_NXP_HSE_MU1
	bool "MU1"
config CRYPTO_DEV_NXP_HSE_MU2
	bool "MU2"
config CRYPTO_DEV_NXP_HSE_MU3
	bool "MU3"
endchoice

config CRYPTO_DEV_NXP_HSE_MU
	string
	depends on CRYPTO_DEV_NXP_HSE
	default mu0b if CRYPTO_DEV_NXP_HSE_MU0
	default mu1b if CRYPTO_DEV_NXP_HSE_MU1
	default mu2b if CRYPTO_DEV_NXP_HSE_MU2
	default mu3b if CRYPTO_DEV_NXP_HSE_MU3

comment "MU interface must be activated by HSE firmware before use"
	depends on CRYPTO_DEV_NXP_HSE && !CRYPTO_DEV_NXP_HSE_MU0

config CRYPTO_DEV_NXP_HSE_AHASH
	bool "Message Digest Support"
	depends on CRYPTO_DEV_NXP_HSE
	select CRYPTO_HASH
	default y
	help
	  Enables hash and hash-based MAC offloading to HSE.

config CRYPTO_DEV_NXP_HSE_SKCIPHER
	bool "Symmetric Key Cipher Support"
	depends on CRYPTO_DEV_NXP_HSE
	select CRYPTO_SKCIPHER
	default y
	help
	  Enables symmetric key cipher offloading to HSE.

config CRYPTO_DEV_NXP_HSE_AEAD
	bool "AuthEnc and AEAD Support"
	depends on CRYPTO_DEV_NXP_HSE
	select CRYPTO_AEAD
	default y
	help
	  Enables authenticated encryption and AEAD offloading to HSE.

config CRYPTO_DEV_NXP_HSE_RNG
	bool "Hardware TRNG support"
	depends on CRYPTO_DEV_NXP_HSE
	select HW_RANDOM
	default y
	help
	  Enables hardware true random number generation via HSE.

config CRYPTO_DEV_NXP_HSE_RNG_CACHE
	int "Entropy cache maximum size"
	depends on CRYPTO_DEV_NXP_HSE_RNG
	range 64 512
	default 512
	help
	  Total size of driver entropy cache. Used to improve request latency.

menu "RAM Key Catalog AES Group Configuration"
depends on CRYPTO_DEV_NXP_HSE
visible if CRYPTO_DEV_NXP_HSE_SKCIPHER || CRYPTO_DEV_NXP_HSE_AEAD

config CRYPTO_DEV_NXP_HSE_AES_KEY_GROUP_ID
	int "AES 256-bit Key Group ID within RAM Key Catalog"
	depends on CRYPTO_DEV_NXP_HSE
	range 0 255
	default "0" if CRYPTO_DEV_NXP_HSE_SKCIPHER || CRYPTO_DEV_NXP_HSE_AEAD
	default "0"
	help
	  The AES 256-bit Key Group ID within RAM Key Catalog.

config CRYPTO_DEV_NXP_HSE_AES_KEY_GROUP_SIZE
	int "Number of key slots in the AES 256-bit Key Group"
	depends on CRYPTO_DEV_NXP_HSE
	range 0 255
	default "4" if CRYPTO_DEV_NXP_HSE_SKCIPHER || CRYPTO_DEV_NXP_HSE_AEAD
	default "0"
	help
	  Number of key slots available in the 256-bit AES Key Group.

endmenu

menu "RAM Key Catalog HMAC Group Configuration"
depends on CRYPTO_DEV_NXP_HSE
visible if CRYPTO_DEV_NXP_HSE_AHASH

config CRYPTO_DEV_NXP_HSE_HMAC_KEY_GROUP_ID
	int "HMAC 1024-bit Key Group ID within RAM Key Catalog"
	depends on CRYPTO_DEV_NXP_HSE
	range 0 255
	default "1" if CRYPTO_DEV_NXP_HSE_AHASH
	default "0"
	help
	  The HMAC 1024-bit Key Group ID within RAM Key Catalog.

config CRYPTO_DEV_NXP_HSE_HMAC_KEY_GROUP_SIZE
	int "Number of key slots in the HMAC 1024-bit Key Group"
	depends on CRYPTO_DEV_NXP_HSE
	range 0 255
	default "4" if CRYPTO_DEV_NXP_HSE_AHASH
	default "0"
	help
	  Number of key slots available in the HMAC 1024-bit Key Group.

endmenu

config CRYPTO_DEV_NXP_HSE_DEBUG
        bool "Debug information for HSE crypto driver"
	depends on CRYPTO_DEV_NXP_HSE
        default n
	help
	  Enables printing crypto driver debug messages to the kernel log.
```

## drivers/misc/fccu/Kconfig
```kconfig
#
# FCCU device configuration
#

config S32CC_FCCU
	tristate "Fault Collection and Control Unit"
	depends on SOC_S32CC
	help
	  This is the driver for Fault Collection and Control Unit
	  on the NXP S32CC SoC.
	  This module is used to collect and control fault signals from
	  peripherals. It requires a correct configuration to enable
	  reception and react to a signal from a channel.
```

## drivers/net/can/llce/Kconfig
```kconfig
# SPDX-License-Identifier: GPL-2.0-only
menuconfig CAN_LLCE
	select NXP_LLCE_MBOX
	select LLCE_CORE
	depends on CAN_DEV && m
	bool "NXP LLCE CAN support"
	help
	  Say Y here if you want support for NXP LLCE CAN drivers.
	  This is common support for devices that embed the NXP LLCE CAN IP.

	  If unsure choose N.

if CAN_LLCE

config CAN_LLCE_CONTROLLER
	tristate "LLCE CAN"
	depends on m
	help
	  Driver for CAN interface of the NXP LLCE accelerator. The CAN
	  interface is one of the offloaded communication channels of the
	  Low Latency Communication Engine. The hardware channels abstract
	  the communication that is fully supported through a
	  firmware-defined host interface.

endif
```

## drivers/pinctrl/nxp/Kconfig
```kconfig
# SPDX-License-Identifier: GPL-2.0-only
config PINCTRL_S32CC
	tristate "Driver for the NXP S32CC family pin controller"
	depends on ARCH_S32 && OF
	select GENERIC_PINCTRL_GROUPS
	select GENERIC_PINMUX_FUNCTIONS
	select GENERIC_PINCONF
	select REGMAP_MMIO

config PINCTRL_SCMI
	tristate "Pinctrl driver over SCMI"
	depends on ARM_SCMI_PROTOCOL
	help
	  This driver provides pinctrl support for firmwares
	  that implement it. Communication with the firmware
	  will occur over SCMI.
```
