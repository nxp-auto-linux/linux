## Documentation/devicetree/bindings/net/nxp,s32g-pfe.yaml
```yaml
# SPDX-License-Identifier: (GPL-2.0-only OR BSD-2-Clause)
# Copyright 2022-2023 NXP
%YAML 1.2
---
$id: "http://devicetree.org/schemas/net/nxp,s32g-pfe.yaml#"
$schema: "http://devicetree.org/meta-schemas/core.yaml#"

title: The PFE Ethernet accelerator with three MACs (Media Access Controller)

maintainers:
  - Jan Petrous <jan.petrous@nxp.com>
  - Claudiu Manoil <claudiu.manoil@nxp.com>

description: |
  The NXP S32G2/S32G3 automotive SoC contains PFE Ethernet controller.
  PFE offloads Ethernet packet processing from the host cores, yielding
  higher performance and lower power consumption than what software
  processing alone could achieve.

properties:
  "#address-cells": true
  "#size-cells": true

  compatible:
    items:
      - enum:
          - nxp,s32g-pfe
          - nxp,s32g-pfe-slave
          - nxp,s32g-pfe-bdr-pool
      - description: The single instance driver (aka standalone driver mode) or Master driver
      - description: The Slave driver
      - description: Reserved memory for BDR pool

  reg:
    items:
      - description: The PFE IP physical base address and size
      - description: The SoC S32G MEM_GPR base address and size

  reg-names:
    items:
      - const: pfe-cbus
      - const: s32g-main-gpr

  clocks:
    items:
      - description: PFE SYS clock
      - description: PFE PE clock
      - description: TS clock

  clock-names:
    maxItems: 3
    oneOf:
      - items:
          - const: pfe_sys
          - const: pfe_pe
          - const: pfe_ts
      - items:
          - const: pfe_sys
          - const: pfe_pe

  interrupts:
    items:
      - description: HIF channel 0 interrupt
      - description: HIF channel 1 interrupt
      - description: HIF channel 2 interrupt
      - description: HIF channel 3 interrupt
      - description: BMU interrupt
      - description: UTIL interrupt
      - description: SAFETY interrupt

  interrupt-names:
    items:
      - const: hif0
      - const: hif1
      - const: hif2
      - const: hif3
      - const: bmu
      - const: upegpt
      - const: safety

  dma-coherent: true

  resets:
    maxItems: 1
    description: |
      Reference S32G reset controller used for PFE reset.

  resets-names:
    maxItems: 1

  memory-region:
    minItems: 1
    items:
      - description: The BMU2 buffer pool, must be in the range 0x00020000 - 0xbfffffff
      - description: RT region
      - description: Non-cacheable DMA buffers
      - description: Buffer descriptor rings

  memory-region-names:
    minItems: 1
    items:
      - const: pfe-bmu2-pool
      - const: pfe-rt-pool
      - const: pfe-shared-pool
      - const: pfe-bdr-pool

  nxp,fw-class-name:
    $ref: /schemas/types.yaml#/definitions/string
    description: |
      If present, name (or relative path) of the file within the
      firmware search path containing the firmware image used when
      initializing PFE CLASS hardware.

  nxp,fw-util-name:
    $ref: /schemas/types.yaml#/definitions/string
    description: |
      If present, name (or relative path) of the file within the
      firmware search path containing the firmware image used when
      initializing PFE UTIL hardware. Optional.

  nxp,pfeng-emac-ts-ext-modes:
    $ref: /schemas/types.yaml#/definitions/uint32-array
    description: |
      The set of PFE_EMACs required to work in external timestamping
      mode. The combination of external TS support is limited,
      check S32G Reference Manual for detailed info.
    maxItems: 3
    contains:
      enum:
        - PFE_PHYIF_EMAC_0
        - PFE_PHYIF_EMAC_1
        - PFE_PHYIF_EMAC_2

  nxp,pfeng-ihc-channel:
    $ref: /schemas/types.yaml#/definitions/uint32
    description: |
      The HIF channel number used for IHC transport.
    contains:
      enum:
        - PFE_PHYIF_HIF_0
        - PFE_PHYIF_HIF_1
        - PFE_PHYIF_HIF_2
        - PFE_PHYIF_HIF_3

  nxp,pfeng-master-channel:
    $ref: /schemas/types.yaml#/definitions/uint32
    description: |
      The HIF channel number used for IHC transport.
      The destination channel used by Master for
      receiving IHC messages. Here can also be used
      the HIF_NCPY channel.
    contains:
      enum:
        - PFE_PHYIF_HIF_0
        - PFE_PHYIF_HIF_1
        - PFE_PHYIF_HIF_2
        - PFE_PHYIF_HIF_3
        - PFE_PHYIF_HIF_NOCPY

  nvmem-cells:
    minItems: 5
    description:
      Reference to the NVMEM nodes used for accessing GPRs for PFE
      configuration.

  nvmem-cell-names:
    items:
      - const: "pfe_emacs_intf_sel"
      - const: "pfe_coh_en"
      - const: "pfe_pwr_ctrl"
      - const: "pfe_emacs_genctrl1"
      - const: "pfe_genctrl3"

  phys:
    maxItems: 3

  phy-names:
    description: |
      Required for SGMII mode. Should reference
      S32G SerDes XPCS instance. One per PFE_EMAC.
    maxItems: 3
    contains:
      enum:
        - emac0_xpcs
        - emac1_xpcs
        - emac2_xpcs

  # mdio
  mdio:
    $ref: mdio.yaml#
    description: |
      Optional node for embedded MDIO controller.
    properties:
      compatible:
        items:
          - const: nxp,s32g-pfe-mdio
      reg:
        maxItems: 1
        description: The index of embedded MDIO bus.

  # ethernet
  ethernet:
    $ref: ethernet-controller.yaml#
    description: |
      Describes net device.
    properties:
      compatible:
        items:
          - const: nxp,s32g-pfe-netif
      local-mac-address: true
      phy-mode: true
      phy-handle: true
      nxp,pfeng-if-name:
        $ref: /schemas/types.yaml#/definitions/string
        description: |
          The netdev interface name.
      nxp,pfeng-hif-channels:
        $ref: /schemas/types.yaml#/definitions/uint32-array
        description: |
          The set of used HIF channels. Any combination of standard
          HIF channel can be used. HIF_NOCPY is not supported.
        minItems: 1
        maxItems: 4
        contains:
          enum:
            - PFE_PHYIF_HIF_0
            - PFE_PHYIF_HIF_1
            - PFE_PHYIF_HIF_2
            - PFE_PHYIF_HIF_3
      nxp,pfeng-emac-id:
        $ref: /schemas/types.yaml#/definitions/uint32
        description: |
          The linked PFE_EMAC port. Use nxp,pfeng-linked-phyif instead.
        deprecated: true
      nxp,pfeng-linked-phyif:
        $ref: /schemas/types.yaml#/definitions/uint32
        description: |
          The linked PFE physical port.
        contains:
          enum:
            - PFE_PHYIF_EMAC_0
            - PFE_PHYIF_EMAC_1
            - PFE_PHYIF_EMAC_2
            - PFE_PHYIF_HIF_NOCPY
            - PFE_PHYIF_HIF_0
            - PFE_PHYIF_HIF_1
            - PFE_PHYIF_HIF_2
            - PFE_PHYIF_HIF_3
      nxp,pfeng-netif-mode-aux:
        $ref: /schemas/types.yaml#/definitions/flag
        description: |
          If present, the netdevice is used in AUX mode.

required:
  - compatible
  - reg
  - reg-names
  - interrupts
  - interrupt-names
  - '#address-cells'
  - '#size-cells'
  - ethernet

unevaluatedProperties: false

allOf:
  - if:
      properties:
        compatible:
          contains:
            const: nxp,s32g-pfe
    then:
      required:
        - clocks
        - clock-names
    else:
      required:
        - nxp,pfeng-master-channel
```

## Documentation/devicetree/bindings/nvmem/fsl,s32-siul2-nvmem.yaml
```yaml
# SPDX-License-Identifier: (GPL-2.0 or BSD-2-Clause)
%YAML 1.2
---
$id: http://devicetree.org/schemas/nvmem/fsl,s32-siul2-nvmem.yaml#
$schema: http://devicetree.org/meta-schemas/core.yaml#

title: NXP S32 SIUL2 NVMEM driver

maintainers:
  - Catalin Udma <catalin-dan.udma@nxp.com>

description: |
  The drivers provides a unique interface to access non volatile SoC
  information from SIUL2 module, for example SoC Revision

allOf:
  - $ref: "nvmem.yaml#"

properties:
  compatible:
    description: |-
      Each compatible string provides an interface for
      SIUL2_0 or SIUL2_1 module.
      const: fsl,s32gen1-siul2_0-nvmem
      const: fsl,s32gen1-siul2_1-nvmem

  reg:
    description:
      Address and Size of the SIUL2 MCU ID Registers (MIDR1 & MIDR2).
    maxItems: 1

  '#address-cells':
    const: 1

  '#size-cells':
    const: 1

required:
  - compatible
  - reg
  - '#address-cells'
  - '#size-cells'

unevaluatedProperties: false

examples:
  - |
    nvram: nvram@4009C000 {
      compatible = "fsl,s32gen1-siul2_0-nvmem";
      reg = <0x0 10>;
      #address-cells = <1>;
      #size-cells = <1>;
      status = "okay";
      soc_revision: soc_revision@0 {
              reg = <SOC_REVISION_OFFSET NVRAM_CELL_SIZE>;
      };
      pcie_variant: pcie_variant@4 {
              reg = <PCIE_VARIANT_OFFSET NVRAM_CELL_SIZE>;
      };
    };
```

## Documentation/devicetree/bindings/nvmem/nxp,s32-ocotp-nvmem.yaml
```yaml
# SPDX-License-Identifier: (GPL-2.0 or BSD-2-Clause)
%YAML 1.2
---
$id: http://devicetree.org/schemas/nvmem/nxp,s32-ocotp-nvmem.yaml#
$schema: http://devicetree.org/meta-schemas/core.yaml#

title: NXP S32 OCOTP NVMEM driver

maintainers:
  - Ciprian Costea <ciprianmarian.costea@nxp.com>

description: |
  The drivers provides an interface to access One Time
  Programmable memory pages, such as TMU fuse values.

allOf:
  - $ref: "nvmem.yaml#"

properties:
  compatible:
    description: |-
      Each compatible string provides an interface for
      OCOTP module.
      const: nxp,s32g-ocotp
      const: nxp,s32r45-ocotp

  reg:
    description:
      Address and Size of the fuse bank to be read.
    maxItems: 1

  '#address-cells':
    const: 1

  '#size-cells':
    const: 1

required:
  - compatible
  - reg
  - '#address-cells'
  - '#size-cells'

unevaluatedProperties: false

examples:
  - |
    #include <dt-bindings/nvmem/s32-ocotp-nvmem.h>

    ocotp: ocotp@400a4000 {
      compatible = "nxp,s32g-ocotp";
      reg = <0x0 0x400a4000 0x0 0x400>;
      #address-cells = <1>;
      #size-cells = <1>;
      status = "okay";
      tmu_fuse_val: tmu_fuse_val@298 {
              reg = <TMU_FUSE_OFFSET OCOTP_CELL_SIZE>;
      };
    };
```

## Documentation/devicetree/bindings/nvmem/nxp,s32cc-gpr-nvmem.yaml
```yaml
# SPDX-License-Identifier: (GPL-2.0 or BSD-2-Clause)
%YAML 1.2
---
$id: http://devicetree.org/schemas/nvmem/nxp,s32cc-gpr-nvmem.yaml#
$schema: http://devicetree.org/meta-schemas/core.yaml#

title: NXP S32CC GPR NVMEM driver

maintainers:
  - Andrei Cherechesu <andrei.cherechesu@nxp.com>

description: |
  This is a driver to read/write hardware-related control data within
  S32CC GPRs for the S32CC SoCs, through the Linux NVMEM Framework.
  The GPR control registers group is comprised of: SRC, CM7_GPR, A53_GPR,
  SERDES_GPR, DDR_GPR, SRC_GPR and Boot_CC.

allOf:
  - $ref: "nvmem.yaml#"

properties:
  compatible:
    - enum:
      - nxp,s32g-gpr-nvmem
      - nxp,s32r45-gpr-nvmem
    - const: nxp,s32cc-gpr-nvmem

  reg:
    description:
      Address and size of the GPRs MMIO region.

  '#address-cells':
    const: 1

  '#size-cells':
    const: 1

required:
  - compatible
  - reg
  - '#address-cells'
  - '#size-cells'

unevaluatedProperties: false

examples:
  - |
    #include <dt-bindings/nvmem/s32cc-gpr-nvmem.h>

    gpr: gpr@4007c000 {
      compatible = "nxp,s32cc-gpr-nvmem";
      reg = <0x0 0x4007c000 0x0 0x3000>;
      #address-cells = <1>;
      #size-cells = <1>;
      status = "okay";

      ddr_pmu_irq: ddr_pmu_irq@0 {
        reg = <S32CC_GPR_DDR_PMU_IRQ_OFFSET S32CC_GPR_CELL_SIZE>;
      };
      gmac0_phy_intf_sel: gmac0_phy_intf_sel@1 {
        reg = <S32CC_GPR_GMAC0_PHY_INTF_SEL_OFFSET S32CC_GPR_CELL_SIZE>;
      };
    };
```

## Documentation/devicetree/bindings/nvmem/nxp,s32cc-siul2-nvmem.yaml
```yaml
# SPDX-License-Identifier: (GPL-2.0 or BSD-2-Clause)
%YAML 1.2
---
$id: http://devicetree.org/schemas/nvmem/nxp,s32cc-siul2-nvmem.yaml#
$schema: http://devicetree.org/meta-schemas/core.yaml#

title: NXP S32CC SIUL2 NVMEM driver

maintainers:
  - Catalin Udma <catalin-dan.udma@nxp.com>

description: |
  The drivers provides a unique interface to access non volatile SoC
  information from SIUL2 module, for example SoC Revision

allOf:
  - $ref: "nvmem.yaml#"

properties:
  compatible:
    description: |-
      Each compatible string provides an interface for
      SIUL2_0 or SIUL2_1 module.
      const: nxp,s32cc-siul2_0-nvmem
      const: nxp,s32g2-siul2_0-nvmem
      const: nxp,s32cc-siul2_1-nvmem

  reg:
    description:
      Address and Size of the SIUL2 MCU ID Registers (MIDR1 & MIDR2).
    maxItems: 1

  '#address-cells':
    const: 1

  '#size-cells':
    const: 1

required:
  - compatible
  - reg
  - '#address-cells'
  - '#size-cells'

unevaluatedProperties: false

examples:
  - |
    #include <dt-bindings/nvmem/s32cc-siul2-nvmem.h>

    nvram: nvram@4009C000 {
      compatible = "nxp,s32cc-siul2_0-nvmem";
      reg = <0x0 10>;
      #address-cells = <1>;
      #size-cells = <1>;
      status = "okay";
      soc_major: soc_major@0 {
        reg = <SOC_MAJOR_OFFSET NVRAM_CELL_SIZE>;
      };
      soc_minor: soc_minor@1 {
        reg = <SOC_MINOR_OFFSET NVRAM_CELL_SIZE>;
      };
      pcie_dev_id: pcie_dev_id@2 {
        reg = <PCIE_DEV_ID_OFFSET NVRAM_CELL_SIZE>;
      };
    };
```
