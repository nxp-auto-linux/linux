## Documentation/devicetree/bindings/net/can/fsl-llcelogger.yaml
```yaml
# SPDX-License-Identifier: GPL-2.0
%YAML 1.2
---

title: LLCE engine on NXP's ARM based SOCs.

maintainers: Dorin Ionita <dorin.ionita@nxp.com>

description: |
  This driver is used on S32G2xx to log CAN messages received from LLCE.
  It provides a interface to userspace, as a char device, on which you
  can cat or you can echo a value to set the log size to that dimension.
  Separate LLCE configuration for CAN is expected.
  It assumes that the LLCE Firmware is already loaded.

properties:
  compatible:
    const:
      - fsl,s32g-llcelogger

  reg:
    description: |
      Offset and length of the register set or shared memory regions
      for this device (LLCE HW IP)

  reg-names:
    description: |
      Name for the mapped registers or shared memory regions

  interrupts:
    description: |
      Interrupt tuple for this device - CAN frame processed.

required:
  - compatible
  - reg
  - reg-names
  - interrupts

additionalProperties: false

examples:
  - |
    llce: llcelogger@43000000 {
      compatible = "fsl,s32g-llcelogger";
      reg = <0x0 0x43000000 0x0 0x1000000>,
        <0x0 0x43800000 0x0 0x3D000>,
        <0x0 0x43A0C40C 0x0 0x4>,
        <0x0 0x43A0C424 0x0 0x4>,
        <0x0 0x43A0C014 0x0 0x4>,
        <0x0 0x43A0C408	0x0 0x4>;
      reg-names = "llce-range",
        "llce-shared-mem",
        "fifo-ier",
        "fifo-pop0",
        "fifo-push0",
        "fifo-status1";
        interrupts = <0x0 184 0x4>;
    };
...
```

## Documentation/devicetree/bindings/net/can/nxp,s32g-llce-can-core.yaml
```yaml
# SPDX-License-Identifier: (GPL-2.0-only or BSD-2-Clause)
%YAML 1.2
---
$id: http://devicetree.org/schemas/net/can/nxp,s32g-llce-can-core.yaml#
$schema: http://devicetree.org/meta-schemas/core.yaml#

title: LLCE CAN Core module

maintainers:
  - Ghennadi Procopciuc <ghennadi.procopciuc@nxp.com>

description: |
  This driver includes common functionalities for the LLCE CAN controller interfaces.

properties:
  compatible:
    const: nxp,s32g-llce-can-core

  mbox-names:
    items:
      - const: config

  mboxes:
    description: |
      Configuration channel.

required:
  - compatible
  - mboxes
  - mbox-names

additionalProperties: false

examples:
  - |
    #include <dt-bindings/mailbox/nxp-llce-mb.h>
    llce_can_core: llce_can_core {
        compatible = "nxp,s32g-llce-can-core";
        mboxes = <&llce_mb S32G_LLCE_CAN_CORE_CONFIG_MB 0>;
        mbox-names = "config";
        status = "okay";
    };
```

## Documentation/devicetree/bindings/net/can/nxp,s32g-llce-can-logger.yaml
```yaml
# SPDX-License-Identifier: (GPL-2.0-only or BSD-2-Clause)
%YAML 1.2
---
$id: http://devicetree.org/schemas/net/can/nxp,s32g-llce-can-logger.yaml#
$schema: http://devicetree.org/meta-schemas/core.yaml#

title: LLCE CAN Logger on NXP's ARM based SOCs.

maintainers:
  - Dorin Ionita <dorin.ionita@nxp.com>

description: |
  This driver is used on S32G2xx to log CAN messages received from LLCE.
  It provides a interface to userspace, as a vcan interface.
  Separate LLCE configuration for CAN is expected.
  It assumes that the LLCE Firmware is already loaded.

properties:
  compatible:
    const: nxp,s32g-llce-can-logger

  mboxes:
    description: |
      Must be an array of two mbox channels. The array must have a channel of
      type S32G_LLCE_CAN_LOGGER_CONFIG_MB and the other one of type
      S32G_LLCE_CAN_LOGGER_MB.
      Link to LLCE CAN Logger mailbox.
      (see mailbox/nxp,s32g-llce-mailbox.yaml for more details)

  mbox-names:
    description: |
      Must be an array of two strings. One of them must be "config" and the
      other one must be "rx". The strings must be in the same order as mbox
      channels.
    items:
      - const: config
      - const: rx

required:
  - compatible
  - mboxes
  - mbox-names

additionalProperties: false

examples:
  - |
    #include <dt-bindings/mailbox/nxp-llce-mb.h>
    llce_can_logger: llce_can_logger {
      compatible = "nxp,s32g-llce-can-logger";
      mboxes = <&llce_mb S32G_LLCE_CAN_LOGGER_CONFIG_MB 0>,
        <&llce_mb S32G_LLCE_CAN_LOGGER_MB 0>;
      mbox-names = "config", "rx";
    };
...
```

## Documentation/devicetree/bindings/net/fsl,sja1105-switch.yaml
```yaml
# SPDX-License-Identifier: (GPL-2.0-only OR BSD-2-Clause)
%YAML 1.2
---
$id: http://devicetree.org/schemas/net/fsl,sja1105-switch.yaml#
$schema: http://devicetree.org/meta-schemas/core.yaml#

title: SJA1105 Ethernet Switch controller from NXP

maintainers:
  - Larisa Grigore <larisa.grigore@nxp.com>

allOf:
  - $ref: "/schemas/serial/rs485.yaml"

properties:
  compatible:
    oneOf:
      - enum:
          - nxp,sja1105-switch
          - nxp,sja1105-switch-1-2
          - nxp,sja1105-switch-2-2
          - nxp,sja1105-switch-1-3
          - nxp,sja1105-switch-2-3
          - nxp,sja1105-switch-3-3

  reg:
    items:
      - description: Should specify the chip select of SPI controller
                     used to select this switch

  spi-max-frequency:
    items:
      - description: Maximum frequency used for communication between
                     SPI controller and SJA1105 switch

  spi-cpha:
    description: SJA1105 switch needs to be configure 0x1 SPI mode

  rs485-rts-active-low: true
  linux,rs485-enabled-at-boot-time: true

patternProperties:
  '^port-[0-9]+':
    type: object
    description:
      Port node specifies the configuration of the nth port
      of the switch

required:
  - compatible
  - reg
  - spi-max-frequency
  - spi-cpha
  - port-0
  - port-1
  - port-2
  - port-3
  - port-4

unevaluatedProperties: false

examples:
  - |
    sja1105_0: sja1105@0 {
             compatible = "nxp,sja1105-switch-1-3";
             spi-max-frequency = <4000000>;
             spi-cpha;
             reg = <0x0 0x0>;
             port-0 {
                     is-host = <1>;
                     speed = <1000>;
                     xmii-mode = "RGMII";
                     null-phy =  <1>;
             };
             port-1 {
                     is-host = <0>;
                     speed = <1000>;
                     xmii-mode = "RGMII";
                     null-phy =  <0>;
             };
             port-2 {
                     is-host = <0>;
                     speed = <100>;
                     xmii-mode = "RMII";
                     null-phy = <0>;
             };
             port-3 {
                     is-host = <0>;
                     speed = <1000>;
                     xmii-mode = "RGMII";
                     null-phy = <0>;
             };
             port-4 {
                     is-host = <0>;
                     speed = <1000>;
                     xmii-mode = "RGMII";
                     null-phy = <0>;
             };
    };
```

## Documentation/devicetree/bindings/net/nxp,gmac.txt
```
* NXP S32GEN1 GMAC

Required properties:
- compatible: Should be "fsl,dwc-eqos"
- reg: The location and length of the register set for the device
- interrupt-parent: The phandle for the interrupt controller
- interrupts: The interrupts for the device
- interrupt-names: Should be "macirq"

Example:
gmac0: ethernet@4033c000 {
	compatible = "fsl,dwc-eqos";
	reg = <0x0 0x4033c000 0x0 0x2000>;
	interrupt-parent = <&gic>;
	interrupts = <0 57 4>;
	interrupt-names = "macirq";
};
```

## Documentation/devicetree/bindings/net/nxp,s32cc-dwmac.yaml
```yaml
# SPDX-License-Identifier: (GPL-2.0-only OR BSD-2-Clause)
# Copyright 2021-2022 NXP
%YAML 1.2
---
$id: "http://devicetree.org/schemas/net/nxp,s32cc-dwmac.yaml#"
$schema: "http://devicetree.org/meta-schemas/core.yaml#"

title: NXP S32G/R GMAC ethernet controller

maintainers:
  - Jan Petrous <jan.petrous@nxp.com>

description: |
  This device is a platform glue layer for stmmac.
  Please see snps,dwmac.yaml for the other unchanged properties.

properties:
  compatible:
    enum:
      - nxp,s32cc-dwmac

  reg:
    items:
      - description: Main GMAC registers
      - description: S32CC GMAC_0_CTRL_STS register

  interrupts:
    description: Common GMAC interrupt

  interrupt-names:
    const: macirq

  dma-coherent:
    description:
      Declares GMAC device as DMA coherent

  clocks:
    items:
      - description: Main GMAC clock
      - description: Transmit clock
      - description: Receive clock
      - description:
          PTP reference clock. This clock is used for programming the
          Timestamp Addend Register. If not passed then the system
          clock will be used and this is fine on some platforms.

  clock-names:
    items:
      - const: stmmaceth
      - const: tx
      - const: rx
      - const: ptp_ref

  phy-handle:
    $ref: /schemas/types.yaml#/definitions/phandle
    description:
      The device node referenced by "phy" or "phy-handle" must be a child node
      of the mdio node. See phy.txt for the generic PHY bindings.

  phy:
    $ref: /schemas/types.yaml#/definitions/phandle

  phys:
    description: S32G serdes XPCS for sgmii operation

  phy-names:
    const: gmac_xpcs
    description: S32G serdes XPCS name for sgmii operation

  nvmem-cells:
    description:
      Reference to the NVMEM node used for accessing GPRs for GMAC
      configuration.

  nvmem-cell-names:
    items:
      - const: "gmac_phy_intf_sel"

patternProperties:
  "^mdio[@a-f0-9]+$":
    type: object
    description:
      Optional mdio node

    properties:
      compatible:
        const: snps,dwmac-mdio

    required:
      - compatible

    additionalProperties: true

required:
  - compatible
  - reg
  - interrupts
  - interrupt-parent
  - dma-coherent
  - clocks
  - clock-names

additionalProperties: true

examples:
  - |
    #include <dt-bindings/interrupt-controller/arm-gic.h>
    #include <dt-bindings/interrupt-controller/irq.h>
    #include <dt-bindings/phy/phy.h>
    #define S32CC_SCMI_CLK_GMAC0_AXI
    #define S32CC_SCMI_CLK_GMAC0_TX_RGMII
    #define S32CC_SCMI_CLK_GMAC0_RX_SGMII
    #define S32CC_SCMI_CLK_GMAC0_TS
    bus {
      #address-cells = <2>;
      #size-cells = <2>;

      gmac0: ethernet@4033c000 {
        compatible = "nxp,s32cc-dwmac";
        reg = <0x0 0x4033c000 0x0 0x2000>, /* gmac IP */
              <0x0 0x4007c004 0x0 0x4>;    /* GMAC_0_CTRL_STS */
        interrupt-parent = <&gic>;
        interrupts = <GIC_SPI 57 IRQ_TYPE_LEVEL_HIGH>;
        interrupt-names = "macirq";
        phy-names = "gmac_xpcs";
        phys = <&serdes0 PHY_TYPE_XPCS 0 0>;
        dma-coherent;
        snps,mtl-rx-config = <&mtl_rx_setup>;
        snps,mtl-tx-config = <&mtl_tx_setup>;
        clocks = <&clks S32CC_SCMI_CLK_GMAC0_AXI>,
           <&clks S32CC_SCMI_CLK_GMAC0_TX_RGMII>,
           <&clks S32CC_SCMI_CLK_GMAC0_RX_RGMII>,
           <&clks S32CC_SCMI_CLK_GMAC0_TS>;
        clock-names = "stmmaceth", "tx", "rx", "ptp_ref";
        nvmem-cell-names = "gmac_phy_intf_sel";
        nvmem-cells = "<&gmac0_phy_intf_sel>";

        mtl_rx_setup: rx-queues-config {
          snps,rx-queues-to-use = <5>;
          #address-cells = <1>;
          #size-cells = <0>;

          queue0 {
          };
          queue1 {
          };
          queue2 {
          };
          queue3 {
          };
          queue4 {
          };
        };

        mtl_tx_setup: tx-queues-config {
          snps,tx-queues-to-use = <5>;
          #address-cells = <1>;
          #size-cells = <0>;

          queue0 {
          };
          queue1 {
          };
          queue2 {
          };
          queue3 {
          };
          queue4 {
          };
        };

        gmac0_mdio: mdio0 {
          compatible = "snps,dwmac-mdio";
          #address-cells = <1>;
          #size-cells = <0>;
        };
      };
    };
```
