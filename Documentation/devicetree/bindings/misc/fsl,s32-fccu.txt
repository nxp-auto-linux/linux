## Documentation/devicetree/bindings/misc/fsl,s32-fccu.txt
```
Fault Collection and Control Unit in S32v234 or S32-Gen1 Soc

This is a module, it used to collect and control fault signals from
peripherals. It requires a correct configuration to enable reception and react
to a signal from a channel.

After it is configured successfully, a reset signal from a configured channel can
reset system. If a signal is generated before FCCU is configured, the signal
will be ignored.

Required properties:
 - compatible: 		should be set to "fsl,s32v234-fccu" or "fsl,s32gen1-fccu"
 - nxp,ncf_fault_list:	array of faults for NCF_Sn registers
 - reg:				the address range
 - interrupt-names:
	- "fccu_alarm"
	- "fccu_misc"
 - interrupts:
	- fccu alarm state interrupt
	- fccu misc interrupt (configuration timeout)

Optional properties:
 - nxp,ncf_actions : Array of actions for NCF. Available actions are defined in
		     dt-bindings/misc/s32-fccu.h. One can select multiple actions
		     using '|' operator.

Any driver requiring access to FCCU registers should reference it from its own
device tree node.

Example:
    #include <dt-bindings/interrupt-controller/irq.h>
    #include <dt-bindings/clock/s32v234-clock.h>
    #include <dt-bindings/misc/s32-fccu.h>

    fccu@400B0000 {
      compatible = "fsl,s32v234-fccu";
      reg = <0x400B0000 0x1000>;
      interrupts = <0 100 IRQ_TYPE_LEVEL_HIGH>,
                  <0 101 IRQ_TYPE_LEVEL_HIGH>;
      interrupt-names = "fccu_alarm",
                        "fccu_misc";
      clocks = <&clks S32V234_CLK_SYS6>;
      clock-names = "fccu";
      nxp,ncf_fault_list = <35 36 37 38>;
      nxp,ncf_actions = <S32_FCCU_REACTION_ALARM
                S32_FCCU_REACTION_ALARM
                S32_FCCU_REACTION_ALARM
                S32_FCCU_REACTION_ALARM>;
      status = "disabled";
    };
```

## Documentation/devicetree/bindings/misc/fsl,s32v234-mscm.yaml
```yaml
# SPDX-License-Identifier: (GPL-2.0-only OR BSD-2-Clause)
%YAML 1.2
---
$id: http://devicetree.org/schemas/misc/fsl,s32v234-mscm.yaml#
$schema: http://devicetree.org/meta-schemas/core.yaml#

title: Generic on-chip MSCM for S32V234

maintainers:
  - Ionut Vicovan <ionut.vicovan@nxp.com>

description: |
  - Simple iomem memory block containing the mapping of the address space
    of the Miscellaneous System Control Module (MSCM).
    For S32V234 this module occupies a 4 Kb address space.

allOf:
  - $ref: "/schemas/serial/rs485.yaml"

properties:
  compatible:
    enum:
      - fsl,s32v234-mscm

  reg:
    maxItems: 1

  interrupts:
    maxItems: 4

  rs485-rts-active-low: true

  linux,rs485-enabled-at-boot-time: true

required:
  - compatible
  - reg
  - interrupts

unevaluatedProperties: false

examples:
  - |
    mscm1: mscm@40081000 {
         compatible = "fsl,s32v234-mscm";

         reg = <0x40081000 0x1000>;

         /* CPU2CPU interrupts */
         interrupts = <0 0 4 >,
                      <0 1 4 >,
                      <0 2 4 >,
                      <0 3 4 >;
    };
```

## Documentation/devicetree/bindings/misc/fsl,s32v234-shm.yaml
```yaml
# SPDX-License-Identifier: (GPL-2.0-only OR BSD-2-Clause)
%YAML 1.2
---
$id: http://devicetree.org/schemas/misc/fsl,s32v234-shm.yaml#
$schema: http://devicetree.org/meta-schemas/core.yaml#

title: S32V234 Shared Memory Block

maintainers:
  - Ionut Vicovan <ionut.vicovan@nxp.com>

description: |
  - This is a shared memory block to be used by various S32V234 generic devices,
    which require a dedicated contiguous memory block to be reserved
    in the kernel memory space.
    It must reside inside the 'reserved-memory' section of the device tree.
    Device is matched via its bus drivers, and has a number of properties
    that apply to the generic device (independent from the bus).
    It may be used by more than one device at once, as long as each one follows
    a proper synchronization mechanism for accessing the data.

allOf:
  - $ref: "/schemas/serial/rs485.yaml"

properties:
  compatible:
    enum:
      - fsl,s32v234-shm

  reg:
    maxItems: 1

  rs485-rts-active-low: true
  linux,rs485-enabled-at-boot-time: true

required:
  - compatible
  - reg

unevaluatedProperties: false

examples:
  - |
    /* 1Mb shared memory */
    shared_memory: shm@C1000000 {
      compatible = "fsl,s32v234-shm";
      reg = <0xC1000000 0x100000>;    /* 1 MB */
      no-map;
    };

    some-device {
       memory-region = <&shared_memory>;
    };
```

## Documentation/devicetree/bindings/misc/fsl,s32v234-sram.yaml
```yaml
# SPDX-License-Identifier: (GPL-2.0-only OR BSD-2-Clause)
%YAML 1.2
---
$id: http://devicetree.org/schemas/serial/fsl,s32v234-sram.yaml#
$schema: http://devicetree.org/meta-schemas/core.yaml#

title: Generic on-chip SRAM for S32V234

maintainers:
  - Ionut Vicovan <ionut.vicovan@nxp.com>

description: |
  - Simple iomem memory block to be used by APIs requiring SRAM access.
    Compatible to mmio-sram.

allOf:
  - $ref: "rs485.yaml"

properties:
  compatible:
    oneOf:
      - enum:
          - fsl,s32v234-sram
          - mmio-sram

  reg:
    maxItems: 1

rs485-rts-active-low: true
linux,rs485-enabled-at-boot-time: true

required:
  - compatible
  - reg

optional:
  - device_type

unevaluatedProperties: false

examples:
  - |
    sram: sram@3E800000 {
        device_type = "sram";
        compatible = "mmio-sram","fsl,s32v234-sram";
        reg = <0 0x3E800000 0 0x400000>;
    };
```

## Documentation/devicetree/bindings/misc/nxp-s32cc-fccu.yaml
```yaml
# SPDX-License-Identifier: (GPL-2.0-only OR BSD-2-Clause)
%YAML 1.2
---
$id: http://devicetree.org/schemas/misc/fsl,fccu.yaml#
$schema: http://devicetree.org/meta-schemas/core.yaml#

title: Fault Collection and Control Unit (FCCU) for S32GEN1

maintainers:
  - Phu Luu An <phu.luuan@nxp.com>

description: |
  This module is used to collect and control fault signals from
  peripherals. It requires a correct configuration to enable reception and react
  to a signal from a channel.

  After it is configured successfully, a reset signal from a configured channel can
  reset the system. If a signal is generated before FCCU is configured, the signal
  will be ignored.

properties:
  compatible:
    enum:
      - nxp,s32cc-fccu

  nxp,ncf_fault_list:
    description: Array of faults for NCF_Sn registers
    $ref: /schemas/types.yaml#/definitions/uint32-array

  nxp,ncf_actions:
    description: Array of actions for NCF. Available actions are defined in
                 dt-bindings/misc/s32-fccu.h. One can select multiple actions
                 using '|' operator.
    $ref: /schemas/types.yaml#/definitions/uint32-array

  interrupt-names:
    items:
            - const: fccu_alarm
            - const: fccu_misc

  interrupts:
    items:
            - description: fccu alarm state interrupt
            - description: fccu misc interrupt (configuration timeout)

  reg:
    description: The address range

  clocks:
    description: Clock access

  clock-names:
    const: fccu

  status:
    enum:
      - enabled
      - disabled

required:
  - compatible
  - interrupts
  - interrupt-names
  - reg

additionalProperties: false

examples:
  - |
    #include <dt-bindings/interrupt-controller/irq.h>
    #include <dt-bindings/misc/s32-fccu.h>
    #include <dt-bindings/clock/s32gen1-scmi-clock.h>

    fccu: fccu@4030C000 {
      compatible = "nxp,s32cc-fccu";
      reg = <0x0 0x4030C000 0x0 0x3000>;
      interrupts= <0 100 IRQ_TYPE_LEVEL_HIGH>,
      <0 101 IRQ_TYPE_LEVEL_HIGH>;
      interrupt-names = "fccu_alarm",
      "fccu_misc";
      clocks = <&clks S32GEN1_SCMI_CLK_FCCU_MODULE>;
      clock-names = "fccu";
      /* A53 NCF fault list */
      nxp,ncf_fault_list = <0 10 35 36 37 38>;
      nxp,ncf_actions = <S32_FCCU_REACTION_ALARM
                         S32_FCCU_REACTION_ALARM
                         S32_FCCU_REACTION_NONE
                         S32_FCCU_REACTION_NONE
                         S32_FCCU_REACTION_NONE
                         S32_FCCU_REACTION_NONE>;
      status = "disabled";
    };
```

## Documentation/devicetree/bindings/misc/nxp-s32cc-mscm.yaml
```yaml
# SPDX-License-Identifier: (GPL-2.0-only OR BSD-2-Clause)
%YAML 1.2
---
$id: http://devicetree.org/schemas/misc/nxp-s32cc-mscm.yaml#
$schema: http://devicetree.org/meta-schemas/core.yaml#

title: Miscellaneous System Control Module (MSCM)

properties:
  compatible:
    const: nxp,s32cc-mscm

  reg:
    maxItems: 1

  interrupts:
    maxItems: 3

required:
  - compatible
  - reg

unevaluatedProperties: false

examples:
  - |
    #include <dt-bindings/interrupt-controller/arm-gic.h>

    mscm@40198000 {
        compatible = "nxp,s32cc-mscm";
        reg = <0x40198000 0x1000>
        /* CPU2CPU interrupts */
        interrupts = <GIC_SPI 1 IRQ_TYPE_LEVEL_HIGH>, // CPU to M7/A53 interrupt#0
                     <GIC_SPI 2 IRQ_TYPE_LEVEL_HIGH>, // CPU to M7/A53 interrupt#1
                     <GIC_SPI 3 IRQ_TYPE_LEVEL_HIGH>; // CPU to M7/A53 interrupt#2
    };
```

## Documentation/devicetree/bindings/net/can/fsl,flexcan.yaml
```yaml
# SPDX-License-Identifier: (GPL-2.0-only OR BSD-2-Clause)
%YAML 1.2
---
$id: http://devicetree.org/schemas/net/can/fsl,flexcan.yaml#
$schema: http://devicetree.org/meta-schemas/core.yaml#

title:
  Flexcan CAN controller on Freescale's ARM and PowerPC system-on-a-chip (SOC).

maintainers:
  - Marc Kleine-Budde <mkl@pengutronix.de>

allOf:
  - if:
      properties:
        compatible:
          contains:
            enum:
              - nxp,s32cc-flexcan
    then:
      properties:
        interrupts:
          minItems: 4
          maxItems: 4
      required:
        - interrupt-names
    else:
      properties:
        interrupts:
          minItems: 1
          maxItems: 1

properties:
  compatible:
    oneOf:
      - enum:
          - fsl,imx8qm-flexcan
          - fsl,imx8mp-flexcan
          - fsl,imx6q-flexcan
          - fsl,imx28-flexcan
          - fsl,imx25-flexcan
          - fsl,p1010-flexcan
          - fsl,vf610-flexcan
          - fsl,ls1021ar2-flexcan
          - fsl,lx2160ar1-flexcan
          - nxp,s32cc-flexcan
      - items:
          - enum:
              - fsl,imx53-flexcan
              - fsl,imx35-flexcan
          - const: fsl,imx25-flexcan
      - items:
          - enum:
              - fsl,imx7d-flexcan
              - fsl,imx6ul-flexcan
              - fsl,imx6sx-flexcan
          - const: fsl,imx6q-flexcan
      - items:
          - enum:
              - fsl,ls1028ar1-flexcan
          - const: fsl,lx2160ar1-flexcan

  reg:
    maxItems: 1

  interrupts:
    description: |
      Interrupt tuple(s) for this device. If interrupt-names are
      missing, these should specify, in order
      for S32CC
      1. BOFFINT | BOFFDONEINT | TWRNINT | RWRNINT;
      2. ERRINT;
      3. MB0-7 interrupts;
      4. MB8-127 interrupts;
      for all the other SoCs
      1. all interrupts combined.
    minItems: 1
    maxItems: 4

  interrupt-names:
    description: |
      Allows the interrupt specifiers in "interrupts" to be stated
      in any order, one for each name in here. Can contain
      "state" - BOFFINT | BOFFDONEINT | TWRNINT | RWRNINT
      "berr" - ERRINT
      "mb_0-7" - MB0-7 interrupts
      "mb_8-127" - MB8-127 interrupts
      "state-berr" - ERRINT | BOFFINT | BOFFDONEINT | TWRNINT | RWRNINT
      "mb" - all MB interrupts
      "all" - all interrupts combined
    items:
      - const: state
      - const: berr
      - const: mb_0-7
      - const: mb_8-127

  clocks:
    maxItems: 2

  clock-names:
    items:
      - const: ipg
      - const: per

  clock-frequency:
    description: |
      The oscillator frequency driving the flexcan device, filled in by the
      boot loader. This property should only be used the used operating system
      doesn't support the clocks and clock-names property.

  xceiver-supply:
    description: Regulator that powers the CAN transceiver.

  big-endian:
    $ref: /schemas/types.yaml#/definitions/flag
    description: |
      This means the registers of FlexCAN controller are big endian. This is
      optional property.i.e. if this property is not present in device tree
      node then controller is assumed to be little endian. If this property is
      present then controller is assumed to be big endian.

  fsl,stop-mode:
    description: |
      Register bits of stop mode control.

      The format should be as follows:
      <gpr req_gpr req_bit>
      gpr is the phandle to general purpose register node.
      req_gpr is the gpr register offset of CAN stop request.
      req_bit is the bit offset of CAN stop request.
    $ref: /schemas/types.yaml#/definitions/phandle-array
    items:
      items:
        - description: |
            The 'gpr' is the phandle to general purpose register node.
        - description: |
            The 'req_gpr' is the gpr register offset of CAN stop request.
          maximum: 0xff
        - description: The 'req_bit' is the bit offset of CAN stop request.
          maximum: 0x1f

  fsl,clk-source:
    description: |
      Select the clock source to the CAN Protocol Engine (PE). It's SoC
      implementation dependent. Refer to RM for detailed definition. If this
      property is not set in device tree node then driver selects clock source 1
      by default.
      0: clock source 0 (oscillator clock)
      1: clock source 1 (peripheral clock)
    $ref: /schemas/types.yaml#/definitions/uint8
    default: 1
    minimum: 0
    maximum: 1

  wakeup-source:
    $ref: /schemas/types.yaml#/definitions/flag
    description:
      Enable CAN remote wakeup.

  fsl,scu-index:
    description: |
      The scu index of CAN instance.
      For SoCs with SCU support, need setup stop mode via SCU firmware, so this
      property can help indicate a resource. It supports up to 3 CAN instances
      now.
    $ref: /schemas/types.yaml#/definitions/uint8
    minimum: 0
    maximum: 2

  termination-gpios: true
  termination-ohms: true

required:
  - compatible
  - reg
  - interrupts

unevaluatedProperties: false

examples:
  - |
    can@1c000 {
        compatible = "fsl,p1010-flexcan";
        reg = <0x1c000 0x1000>;
        interrupts = <48 0x2>;
        interrupt-parent = <&mpic>;
        clock-frequency = <200000000>;
        fsl,clk-source = /bits/ 8 <0>;
    };
  - |
    #include <dt-bindings/interrupt-controller/irq.h>

    can@2090000 {
        compatible = "fsl,imx6q-flexcan";
        reg = <0x02090000 0x4000>;
        interrupts = <0 110 IRQ_TYPE_LEVEL_HIGH>;
        clocks = <&clks 1>, <&clks 2>;
        clock-names = "ipg", "per";
        fsl,stop-mode = <&gpr 0x34 28>;
        fsl,scu-index = /bits/ 8 <1>;
    };
  - |
    #include <dt-bindings/interrupt-controller/irq.h>
    #include <dt-bindings/gpio/gpio.h>

    can@2090000 {
        compatible = "fsl,imx6q-flexcan";
        reg = <0x02090000 0x4000>;
        interrupts = <0 110 IRQ_TYPE_LEVEL_HIGH>;
        clocks = <&clks 1>, <&clks 2>;
        clock-names = "ipg", "per";
        fsl,stop-mode = <&gpr 0x34 28>;
        termination-gpios = <&gpio1 0 GPIO_ACTIVE_LOW>;
        termination-ohms = <120>;
    };
  - |
    #include <dt-bindings/clock/s32cc-scmi-clock.h>
    #include <dt-bindings/interrupt-controller/arm-gic.h>
    #include <dt-bindings/interrupt-controller/irq.h>

    can0: flexcan@401b4000 {
        compatible = "nxp,s32cc-flexcan";
        reg = <0x0 0x401b4000 0x0 0xa000>;
        interrupts = <GIC_SPI 37 IRQ_TYPE_LEVEL_HIGH>,
                   <GIC_SPI 38 IRQ_TYPE_LEVEL_HIGH>,
                   <GIC_SPI 39 IRQ_TYPE_LEVEL_HIGH>,
                   <GIC_SPI 40 IRQ_TYPE_LEVEL_HIGH>;
        interrupt-names = "state", "berr", "mb_0-7", "mb_8-127";
        clocks = <&clks S32CC_SCMI_CLK_FLEXCAN_REG>,
             <&clks S32CC_SCMI_CLK_FLEXCAN_CAN>;
        clock-names = "ipg", "per";
        status = "disabled";
    };
```
