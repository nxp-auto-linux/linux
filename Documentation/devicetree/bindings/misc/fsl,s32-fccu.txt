## Documentation/devicetree/bindings/pci/fsl,s32-pcie.yaml
```yaml
# SPDX-License-Identifier: (GPL-2.0-only OR BSD-2-Clause)
%YAML 1.2
---
$id: http://devicetree.org/schemas/pci/fsl,s32-pcie.yaml#
$schema: http://devicetree.org/meta-schemas/core.yaml#

title: NXP S32 PCIe interface

maintainers:
  - Bogdan Hamciuc <bogdan.hamciuc@nxp.com>

description: |
  This PCIe host controller is based on the Synopsys DesignWare PCIe IP
  and thus inherits all the common properties defined in designware-pcie.txt.

properties:
  compatible:
    oneOf:
      - enum:
          - "fsl,s32v234-pcie"  # S32V234 SoCs
          - "fsl,s32gen1-pcie"  # S32Gen1 SoCs RC mode
          - "fsl,s32gen1-pcie-ep"  # S32Gen1 SoCs EP mode

  reg:
    description: base address and length of the PCIe controller

  interrupts:
    description: A list of interrupt outputs of the controller. Must contain an
      entry for each item in the interrupt-names property.

  fsl,phy-mode:
    description: Select PHY mode for PCIe controller
    oneOf:
      - items:
          - const: "crns"  # Common Reference Clock, No Spread Spectrum
          - const: "crss"  # Common Reference Clock, Spread Spectrum
          - const: "sris"  # Separate Reference Clock, Spread Spectrum

  interrupt-names:
    items:
      - const: "link_req_rst_not"
      - const: "dma"
      - const: "msi"

  msi-parent:
    description: |
      Use this option pointing to the GIC controller node which will
      handle the MSIs. This property can be used only in Root Complex case.
      By default, MSIs are handled by iMSI-RX -Integrated MSI Receiver
      [AXI Bridge]-, an integrated MSI reception module in AXI Bridge which
      detects and terminates inbound MSI requests (received on the RX wire).
      These MSIs will no longer appear on the AXI bus. The disadvantage of this
      approach is that only one hardware interrupt can be used, the one named
      "msi" from the interrupt list, which will make impossible MSIs balancing
      between several cores. If one wants to use more than one hardware
      interrupt, iMSI-RX should be skipped and MSIs should be generated as SPIs.
      This can be achived by adding the "msi-parent" property. The msi-parent
      should be declared as "msi-controller" and the list of available SPIs that
      can be used will be declared using "mbi-ranges".

required:
  - compatible
  - reg
  - interrupts
  - interrupt-names
  - ranges
  - nxp,phy-mode

additionalProperties: true

examples:
  - |

    bus {
        #address-cells = <2>;
        #size-cells = <2>;

        pcie: pcie@72000000 {
          compatible = "fsl,s32v234-pcie";
          reg = <0 0x72ffc000 0 0x4000>, <0 0x72f00000 0 0x80000>;
          reg-names = "dbi", "config";
          #address-cells = <3>;
          #size-cells = <2>;
          device_type = "pci";
          ranges = <0x81000000 0x0 0x0 0x0 0x72f80000 0x0 0x00010000>,
                    /* downstream I/O */
                    <0x82000000 0x0 0x72000000 0x0 0x72000000 0x0 0x00f00000>;
                    /* non-prefetchable memory */
          num-lanes = <1>;
          bus-range = <0x0 0xff>;
          interrupts =  <0 103 4>, <0 104 4>, <0 105 4>;
          interrupt-names = "link_req_rst_not", "dma","msi";
          #interrupt-cells = <1>;
          interrupt-map-mask = <0 0 0 0x7>;
          interrupt-map = <0 0 0 1 &gic 0 108 4>,
              <0 0 0 2 &gic 0 107 4>,
              <0 0 0 3 &gic 0 106 4>,
              <0 0 0 4 &gic 0 105 4>;
          status = "disabled";
        };
      };
```

## Documentation/devicetree/bindings/pci/nxp,s32-pcie.yaml
```yaml
# SPDX-License-Identifier: (GPL-2.0-only OR BSD-2-Clause)
%YAML 1.2
---
$id: http://devicetree.org/schemas/pci/nxp,s32-pcie.yaml#
$schema: http://devicetree.org/meta-schemas/core.yaml#

title: NXP S32CC PCIe interface

maintainers:
  - Bogdan Hamciuc <bogdan.hamciuc@nxp.com>
  - Ionut Vicovan <ionut.vicovan@nxp.com>

description: |
  This PCIe controller is based on the Synopsys DesignWare PCIe IP.
  S32 Common Chassis platform has two PCIe controllers, which can be
  configured as either Root Complex or End Point.
  Each of the controller nodes needs to be referenced by an alias in
  'aliases' section.

properties:
  compatible:
    oneOf:
      - enum:
          - "nxp,s32cc-pcie"  # S32CC SoCs RC mode
          - "nxp,s32cc-pcie-ep"  # S32CC SoCs EP mode

  reg:
    description: base address and length of the PCIe controller
    minItems: 7
    maxItems: 7

  reg-names:
    items:
      - const: dbi
      - const: dbi2
      - const: atu
      - const: dma
      - const: ctrl
      - const: config
      - const: addr_space

  interrupts:
    description: A list of interrupt outputs of the controller. Must contain an
      entry for each item in the interrupt-names property.

  nxp,phy-mode:
    $ref: /schemas/types.yaml#/definitions/string
    description: Select PHY mode for PCIe controller
    enum:
      - crns  # Common Reference Clock, No Spread Spectrum
      - crss  # Common Reference Clock, Spread Spectrum
      - sris  # Separate Reference Clock, Spread Spectrum

  interrupt-names:
    items:
      - const: "link_req_stat"
      - const: "dma"
      - const: "msi"
      - const: "phy_link_down"
      - const: "phy_link_up"
      - const: "misc"
      - const: "pcs"
      - const: "tlp_req_no_comp"

  msi-parent:
    description: |
      Use this option to reference the GIC controller node which will
      handle the MSIs. This property can be used only in Root Complex mode.
      The msi-parent node must be declared as "msi-controller" and the list of
      available SPIs that can be used must be declared using "mbi-ranges".
      If "msi-parent" is not present in the PCIe node, MSIs will be handled
      by iMSI-RX -Integrated MSI Receiver [AXI Bridge]-, an integrated
      MSI reception module in the PCIe controller's AXI Bridge which
      detects and terminates inbound MSI requests (received on the RX wire).
      These MSIs no longer appear on the AXI bus, instead a hard-wired
      interrupt is raised, documented as "DSP AXI MSI Interrupt" in the SoC
      Reference Manual.

  nvmem-cell-names:
    items:
      - const: serdes_presence
      - const: pcie_variant

  nvmem-cells:
    description: |
      phandle to the SerDes presence field cells from MIDR2 register
      from SIUL2_1 module

  device_id:
     description: |
       id of the PCIe controller; used to identify it, apart from the base address

  num-lanes:
     description: |
       max bus width (1 or 2); it is the number of physical lanes

  num-lanes:
     description: |
       max link speed; normaly Gen3, but can be enforced to a lower value
       in case of special limitations

  phy-names:
    description: |
       list of the PCIe PHYs assigned to the SerDes lanes of a particular
       controller; they are usually set internally via SerDes fixups
    items:
      - serdes_lane0
      - serdes_lane1

  shared-mem:
    description: |
      reference to a reserved-memory node which has compatible property set
      to "nxp,s32cc-shm"

  auto-config-bars:
    description:  |
      autoconfigure BARs for EndPoint mode, based on information from shared-mem.

required:
  - compatible
  - reg
  - reg-names
  - interrupts
  - interrupt-names
  - ranges
  - nxp,phy-mode
  - phy-names
  - nvmem-cell-names
  - nvmem-cells

additionalProperties: true

examples:
  - |
    #include <dt-bindings/interrupt-controller/arm-gic.h>
    #include <dt-bindings/interrupt-controller/irq.h>
    bus {
        #address-cells = <2>;
        #size-cells = <2>;

        pcie0: pcie@40400000 {
          compatible = "nxp,s32cc-pcie";
          dma-coherent;
          reg = <0x00 0x40400000 0x0 0x00001000>,   /* dbi registers */
                <0x00 0x40420000 0x0 0x00001000>,   /* dbi2 registers */
                <0x00 0x40460000 0x0 0x00001000>,   /* atu registers */
                <0x00 0x40470000 0x0 0x00001000>,   /* dma registers */
                <0x00 0x40481000 0x0 0x000000F8>,   /* ctrl registers */
                /* RC configuration space, 4KB each for cfg0 and cfg1
                 * at the end of the outbound memory map
                 */
                <0x5f 0xffffe000 0x0 0x00002000>,
                <0x58 0x00000000 0x0 0x40000000>; /* 1GB EP addr space */
          reg-names = "dbi", "dbi2", "atu", "dma", "ctrl",
                "config", "addr_space";
          #address-cells = <3>;
          #size-cells = <2>;
          device_type = "pci";
          device_id = <0>;
          ranges =
            /* downstream I/O, 64KB and aligned naturally just
             * before the config space to minimize fragmentation
             */
            <0x81000000 0x0 0x00000000 0x5f 0xfffe0000 0x0 0x00010000>,
            /* non-prefetchable memory, with best case size and
             * alignment
             */
            <0x82000000 0x0 0x00000000 0x58 0x00000000 0x7 0xfffe0000>;

          nxp,phy-mode = "crns";
          num-lanes = <2>;
          max-link-speed = <3>;
          bus-range = <0x0 0xff>;
          interrupts =  <GIC_SPI 124 IRQ_TYPE_LEVEL_HIGH>,
                        <GIC_SPI 123 IRQ_TYPE_LEVEL_HIGH>,
                        <GIC_SPI 125 IRQ_TYPE_LEVEL_HIGH>,
                        <GIC_SPI 126 IRQ_TYPE_LEVEL_HIGH>,
                        <GIC_SPI 127 IRQ_TYPE_LEVEL_HIGH>,
                        <GIC_SPI 132 IRQ_TYPE_LEVEL_HIGH>,
                        <GIC_SPI 133 IRQ_TYPE_LEVEL_HIGH>,
                        <GIC_SPI 134 IRQ_TYPE_LEVEL_HIGH>;
          interrupt-names = "link_req_stat", "dma", "msi",
                            "phy_link_down", "phy_link_up", "misc",
                            "pcs", "tlp_req_no_comp";
          #interrupt-cells = <1>;
          interrupt-map-mask = <0 0 0 0x7>;
          interrupt-map = <0 0 0 1 &gic 0 0 0 128 4>,
                <0 0 0 2 &gic 0 0 0 129 4>,
                <0 0 0 3 &gic 0 0 0 130 4>,
                <0 0 0 4 &gic 0 0 0 131 4>;
          /* msi-parent = <&gic>; */

          status = "disabled";
        };
    };
```

## Documentation/devicetree/bindings/pinctrl/fsl,s32gen1-siul2-pinctrl.txt
```
* Freescale SIUL2 iomux controller

Core driver for the S32GEN1 pin controller.
Based on fsl,s32v234-siul2-pinctrl implementation.

Required properties:
- compatible:
	* "fsl,s32g-siul2_0-pinctrl"
	* "fsl,s32g-siul2_1-pinctrl"
	* "fsl,s32r45-siul2_0-pinctrl"
	* "fsl,s32r45-siul2_1-pinctrl"

- fsl,pins: two integers array, represents a group of pins mux and config
  setting. The format is fsl,pins = <PIN_FUNC_ID CONFIG>
  PIN_FUNC_ID - id of MSCR to be modified
  CONFIG - configuration to be written in the MSCR/IMCR register

  Even though IMCR register should be used as input register, it can be
  set and addressed in the same way as MSCR, only instead of passing the
  IMCR index, IMCR_IDX + 512 is passed[1].
```

## Documentation/devicetree/bindings/pinctrl/fsl,s32v234-siul2.yaml
```yaml
# SPDX-License-Identifier: GPL-2.0
%YAML 1.2
---

title: Freescale SIUL2 iomux controller

maintainers:
  - Larisa Grigore <larisa.grigore@nxp.com>

description: |
  Core driver for the S32V pin controller.
  Based on fsl,imx-pincontrol implementation.

properties:
  compatible:
    const:
      fsl,s32v234-siul2

  fsl,pins:
    description: |
      Two integers array, represents a group of pins mux and config
      setting. The format is fsl,pins = <PIN_FUNC_ID CONFIG>
      PIN_FUNC_ID - id of MSCR to be modified
      CONFIG - configuration to be written in the MSCR/IMCR register

      Even though IMCR register should be used as input register, it can be
      set and addressed in the same way as MSCR, only instead of passing the
      IMCR index, IMCR_IDX + 512 is passed.

      Refer to s32v234-pinfunc.h in device tree source folder for all
      available s32v234 PIN_FUNC_IDS.

required:
  - compatible
  - fsl,pins

additionalProperties: false

...
```

## Documentation/devicetree/bindings/pinctrl/nxp,s32cc-siul2.yaml
```yaml
# SPDX-License-Identifier: (GPL-2.0-only OR BSD-2-Clause)
%YAML 1.2
---
$id: http://devicetree.org/schemas/pinctrl/nxp,s32cc-siul2.yaml#
$schema: http://devicetree.org/meta-schemas/core.yaml#
title: NXP S32 Common Chassis SIUL2 iomux controller

maintainers:
  - Ghennadi Procopciuc <Ghennadi.Procopciuc@nxp.com>

description: |
  Core driver for the pin controller found on S32 Common Chassis SoC.

properties:
  compatible:
    oneOf:
      - enum:
          - nxp,s32g-siul2-pinctrl
          - nxp,s32r45-siul2-pinctrl

  reg:
    minItems: 5
    maxItems: 6
    description: list of memory regions to be reserved

  nxp,pins:
    $ref: /schemas/types.yaml#/definitions/uint32-array
    description:
      A list composed of [start, end] pins that correspond to each of the
      memory regions reserved.

  '#pinctrl-cells':
    const: 2

required:
  - compatible
  - reg
  - nxp,pins
  - '#pinctrl-cells'


patternProperties:
  '_pins$':
    type: object
    patternProperties:
      '_grp[0-9]$':
        type: object
        allOf:
          - $ref: pinmux-node.yaml#
          - $ref: pincfg-node.yaml#
        description:
          Pinctrl node's client devices specify pin muxes using subnodes,
          which in turn use the standard properties below.

additionalProperties: false

examples:
  - |
    #include <dt-bindings/memory/s32-siul2.h>

    pinctrl: siul2-pinctrl@4009c240 {
        compatible = "nxp,s32g-siul2-pinctrl";
        #pinctrl-cells = <2>;

        reg = <MSCRS_SIUL2_0   0x198>,
              <MSCRS_SIUL2_1_0 0x2c>,
              <MSCRS_SIUL2_1_1 0xbc>,
              <IMCRS_SIUL2_0   0x150>,
              <IMCRS_SIUL2_1_0 0x45c>,
              <IMCRS_SIUL2_1_1 0x108>;

        /* MSCR range */
        nxp,pins = <0   101
                    112 122
                    144 190
        /* IMCR range */
                    512 595
                    631 909
                    942 1007>;

        llce_can0_pins {
            llce_can0_grp0 {
                pinmux = <0x2b0>;
                input-enable;
                slew-rate = <0x00>;
            };

            llce_can0_grp1 {
                pinmux = <0x2c2>;
                output-enable;
                slew-rate = <0x00>;
            };
        };
    };
```

## Documentation/devicetree/bindings/power/reset/fsl,s32gen1-prstc.txt
```
* NXP S32GEN1 Power Reset Controller

Required properties:
- compatible :
  - "fsl,s32gen1-prstc" for device that has an S32GEN1 compatible reboot
  mechanism
- nxp,syscon-mc-me: phandle to MC_ME syscon registers.
- nxp,syscon-mc-rgm: phandle to MC_RGM syscon registers.

Example:
reset_0: reset@40078000 {
	compatible = "fsl,s32gen1-prstc";
	nxp,syscon-mc-me = <&mc_me>;
	nxp,syscon-mc-rgm = <&mc_rgm>;
};
```

## Documentation/devicetree/bindings/power/reset/fsl,s32gen1-reset.yaml
```yaml
# SPDX-License-Identifier: GPL-2.0
%YAML 1.2
---

title: NXP S32GEN1 Reboot

maintainers:
  - Ciprian Costea <ciprianmarian.costea@nxp.com>

description: |
  - Reboot support for the NXP S32GEN1 SoCs

properties:
  compatible:
    const:
      - fsl,s32gen1-reset

  reg:
    description: |
      A pair of addresses and lengths of the register set for the device.
      first one is for the MC RGM registers, the second is for the
      MC ME registers.

required:
  - compatible
  - reg

additionalProperties: false

examples:
  - |
    reset_0: reset@40078000 {
      compatible = "fsl,s32gen1-reset";
        /* MC RGM */
      reg = <0x0 0x40078000 0x0 0x3000>,
        /* MC ME */
        <0x0 0x40088000 0x0 0x1000>;
    };
...
```
