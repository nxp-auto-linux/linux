## Documentation/devicetree/bindings/arm/nxp/nxp-boards.yaml
```yaml
# SPDX-License-Identifier: GPL-2.0-only OR BSD-2-Clause
%YAML 1.2
---
$id: http://devicetree.org/schemas/arm/nxp/nxp-boards.yaml#
$schema: http://devicetree.org/meta-schemas/core.yaml#

title: NXP boards

properties:
  $nodename:
    const: '/'
  compatible:
    oneOf:
      - description: S32G2 based boards
        items:
          - const: nxp,s32g2

      - description: S32R45 based boards
        items:
          - const: fsl,s32r45

      - description: S32G3 based boards
        items:
          - const: nxp,s32g3


required:
  - compatible

additionalProperties: true
```

## Documentation/devicetree/bindings/clock/fsl,s32-stm-global.txt
```
NXP STM timer used as universal time source

This STM timer driver is designed to be used as universal time source
for S32 Gen1 SoCs.

Required properties:
- compatible : "fsl,s32gen1-stm-global"
- reg : Should contain 1 register range(address and length)
- clocks : stm clock
- clock-names : stm

Optional properties:
- interrupts
- cpu

Example:

#include <dt-bindings/clock/s32gen1-scmi-clock.h>

stm0: stm@4000D000{
	compatible = "fsl,s32gen1-stm-global";
	reg = <0x4000D000 0x1000>;
	interrupts = <0 24 4>;
	clocks = <&clks S32GEN1_SCMI_CLK_STM_MODULE>;
	clock-names = "stm";
	status = "disabled";
	cpu = <2>;
};

&stm0 {
	status = "okay";
};
```

## Documentation/devicetree/bindings/clock/fsl,s32-stm.txt
```
Freescale STM timer used as clockevents

This STM timer driver is designed to be used as clockevents
for S32 SoCs.

Required properties:
- compatible : "fsl,s32v234-stm", "fsl,s32gen1-stm"
- reg : Should contain 1 register range(address and length)
- interrupts : One interrupt for STM timer
- cpu: The virtual cpu id which will use the timer as
	clockevents generator.

Optional properties:
- clocks : stm clock
- clock-names : stm

Example 1:

#include <dt-bindings/clock/s32gen1-scmi-clock.h>

stm0: stm@4011C000 {
	compatible = "fsl,s32gen1-stm";
	reg = <0x4011C000 0x3000>;
	interrupts= <0 24 4>;
	clocks = <&clks S32GEN1_SCMI_CLK_STM_MODULE>;
	clock-names = "stm";
	cpu = <2>;
};

Example 2:

#include <dt-bindings/clock/s32v234-clock.h>

stm1: stm@4000D000{
	compatible = "fsl,s32v234-stm";
	reg = <0x4000D000 0x1000>;
	interrupts= <0 19 4>;
	clocks = <&clks S32V234_CLK_SYS6>;
	clock-names = "stm";
	cpu = <1>;
```

## Documentation/devicetree/bindings/clock/fsl-pit.yaml
```yaml
# SPDX-License-Identifier: (GPL-2.0-only OR BSD-2-Clause)
%YAML 1.2
---
$id: http://devicetree.org/schemas/clock/fsl-pit.yaml#
$schema: http://devicetree.org/meta-schemas/core.yaml#

title: Freescale PIT timer used as clocksource/clockevents

maintainers:
  - Larisa Grigore <larisa.grigore@nxp.com>

allOf:
  - $ref: "/schemas/serial/rs485.yaml"

properties:
  compatible:
    oneOf:
      - enum:
          - fsl,vf610-pit
          - fsl,s32v234-pit
          - fsl,s32gen1-pit

  reg:
    maxItems: 1

  interrupts:
    maxItems: 1

  clocks:
    items:
      - description: pit clock

  clock-names:
    items:
      - const: pit

  cpu:
    maxItems: 1

  rs485-rts-active-low: true
  linux,rs485-enabled-at-boot-time: true

required:
  - compatible
  - reg
  - interrupts
  - clocks
  - clock-names
  - cpu

unevaluatedProperties: false

examples:
  - |
    #include <dt-bindings/clock/s32v234-clock.h>

    pit0: pit@4003A000 {
      compatible = "fsl,s32v234-pit";
      reg = <0x4003A000 0x1000>;
      interrupts = <0 31 4>;
      clocks = <&clks S32V234_CLK_SYS6>;
      clock-names = "pit";
      cpu = <0>;
    };
```

## Documentation/devicetree/bindings/clock/fsl-stm-global.yaml
```yaml
# SPDX-License-Identifier: (GPL-2.0-only OR BSD-2-Clause)
%YAML 1.2
---
$id: http://devicetree.org/schemas/serial/fsl-stm-global.yaml#
$schema: http://devicetree.org/meta-schemas/core.yaml#

title: NXP STM timer used as universal time source

maintainers:
  - Dorin Ionita <dorin.ionita@nxp.com>

allOf:
  - $ref: "rs485.yaml"

properties:
  compatible:
    oneOf:
      - enum:
          - fsl,s32gen1-stm-global

  reg:
    maxItems: 1

  interrupts:
    maxItems: 1

  clocks:
    items:
      - description: stm clock
    maxItems: 1

  clock-names:
    items:
      - const: stm
    maxItems: 1

  cpu:
    maxItems: 1

  rs485-rts-active-low: true
  linux,rs485-enabled-at-boot-time: true

required:
  - compatible
  - reg
  - clock
  - clock-names

unevaluatedProperties: false

examples:
  - |
    #include <dt-bindings/clock/s32gen1-scmi-clock.h>

    stm0: stm@4000D000{
        compatible = "fsl,s32gen1-stm-global";
        reg = <0x0 0x4000D000 0x0 0x1000>;
        interrupts= <0 24 4>;
        clocks = <&clks S32GEN1_SCMI_CLK_STM_MODULE>;
        clock-names = "stm";
        cpu = <2>;
        status = "disabled";
    };

    &stm0 {
        status = "okay";
    };
```

## Documentation/devicetree/bindings/clock/nxp-s32cc-stm-global.yaml
```yaml
# SPDX-License-Identifier: (GPL-2.0-only OR BSD-2-Clause)
%YAML 1.2
---
$id: http://devicetree.org/schemas/clock/nxp-s32cc-stm-global.yaml#
$schema: http://devicetree.org/meta-schemas/core.yaml#

title: NXP STM timer used as universal time source

maintainers:
  - Dorin Ionita <dorin.ionita@nxp.com>

properties:
  compatible:
    oneOf:
      - enum:
          - nxp,s32cc-stm-global
          - nxp,s32cc-stm-ts

  reg:
    maxItems: 1

  interrupts:
    maxItems: 1

  clocks:
    items:
      - description: stm clock

  clock-names:
    items:
      - const: stm

  cpu:
    maxItems: 1

  rs485-rts-active-low: true
  linux,rs485-enabled-at-boot-time: true
  nxp,prescaler:
        $ref: /schemas/types.yaml#/definitions/uint32
        minimum: 1
        maximum: 256
        description:
          Selects the module clock divide value for the prescaler, see timer's datasheet

required:
  - compatible
  - reg
  - clocks
  - clock-names

unevaluatedProperties: false

examples:
  - |
    #include <dt-bindings/clock/s32gen1-scmi-clock.h>

    stm0: stm@4000d000{
        compatible = "nxp,s32cc-stm-global";
        reg = <0x4000D000 0x1000>;
        interrupts= <0 24 4>;
        clocks = <&clks S32GEN1_SCMI_CLK_STM_MODULE>;
        clock-names = "stm";
        cpu = <2>;
    };
```

## Documentation/devicetree/bindings/clock/nxp-s32cc-stm.yaml
```yaml
# SPDX-License-Identifier: (GPL-2.0-only OR BSD-2-Clause)
%YAML 1.2
---
$id: http://devicetree.org/schemas/clock/fsl-stm.yaml#
$schema: http://devicetree.org/meta-schemas/core.yaml#

title: Freescale STM timer used as clockevents

maintainers:
  - Larisa Grigore <larisa.grigore@nxp.com>

allOf:
  - $ref: "/schemas/serial/rs485.yaml"

properties:
  compatible:
    oneOf:
      - enum:
          - nxp,s32cc-stm

  reg:
    maxItems: 1

  interrupts:
    maxItems: 1

  clocks:
    items:
      - description: stm clock

  clock-names:
    items:
      - const: stm

  cpu:
    maxItems: 1

  rs485-rts-active-low: true
  linux,rs485-enabled-at-boot-time: true

required:
  - compatible
  - reg
  - interrupts
  - cpu

unevaluatedProperties: false

examples:
  - |
    #include <dt-bindings/clock/s32gen1-scmi-clock.h>

    stm0: stm@4011C000{
        compatible = "nxp,s32cc-stm";
        reg = <0x4011C000 0x3000>;
        interrupts= <0 24 4>;
        clocks = <&clks S32GEN1_SCMI_CLK_STM_MODULE>;
        clock-names = "stm";
        cpu = <2>;
    };
```

## Documentation/devicetree/bindings/clock/s32gen1-clock-generation-modules.yaml
```yaml
# SPDX-License-Identifier: (GPL-2.0-only OR BSD-2-Clause)
%YAML 1.2
---

title: NXP S32GEN1 Clock Generation Modules (MC_CGMs)

maintainers:
  - Ghennadi Procopciuc <Ghennadi.Procopciuc@nxp.com>
  - Larisa Grigore <Larisa.Grigore@nxp.com>

description: |
  Clock Generation Modules provides registers for system and peripherals clock
  source selection and division.

  This binding uses the common clock binding
    Documentation/devicetree/bindings/clock/clock-bindings.txt

properties:
  compatible:
    const:
      - fsl,s32gen1-mc_cgm0  # for MC_CGM_0
      - fsl,s32gen1-mc_cgm1  # for MC_CGM_1
      - fsl,s32gen1-mc_cgm5  # for MC_CGM_5

  reg:
    Location and length of the register set

  clock-cells: |  # (only for MC_CGM_0)
    - Should be <1>. See dt-bindings/clock/s32gen1-clock.h for the clock
      specifiers allowed in the clocks property of consumers.

required:
  - compatible
  - reg
  - clock-cells

additionalProperties: false

examples:
  - |
    clks: mc_cgm0@40030000 {
        compatible = "fsl,s32gen1-mc_cgm0";
        reg = <0x0 0x40030000 0x0 0x3000>;
        #clock-cells = <1>;
    };
...
```

## Documentation/devicetree/bindings/clock/s32gen1-clocking.yaml
```yaml
# SPDX-License-Identifier: (GPL-2.0-only OR BSD-2-Clause)
%YAML 1.2
---

title: NXP S32GEN1 CLOCKING

maintainers:
  - Ghennadi Procopciuc <Ghennadi.Procopciuc@nxp.com>
  - Larisa Grigore <Larisa.Grigore@nxp.com>

description: |
  The internal clocks are generated from one of these input clock sources
  FIRC 48 MHz (mainly used as backup clock)
  SIRC 32 kHz
  FXOSC 20-40 MHz
  PLLs
    CORE_PLL (FM)
    PERIPH_PLL (Non-FM)
    DDR_PLL (Non-FM)
    ACCEL_PLL (FM)
  DFS blocks
    CORE_PLL DFS
    PERIPH_PLL DFS

  The PLLDIG module provides a user interface and control
  over PLL system composed of a single PLL analog block and
  the digital interface. The DFS digital block implements
  registers to control the analog DFS block.

properties:
  compatible:
    const:
      - fsl,s32r45-clocking
      - fsl,s32g274-clocking

  reg:
    Location and length of the register set

required:
  - compatible
  - reg

additionalProperties: false

examples:
  - |
    clks: clocking@40038000 {
        compatible = "fsl,s32r45-clocking";
        reg = <0x0 0x40038000 0x0 0x3000>, /*armpll*/
            <0x0 0x4003C000 0x0 0x3000>, /*periphpll*/
            <0x0 0x40040000 0x0 0x3000>, /*accelpll*/
            <0x0 0x40044000 0x0 0x3000>, /*ddrpll*/
            <0x0 0x40050000 0x0 0x3000>, /*xosc*/
            <0x0 0x40054000 0x0 0x3000>, /*armdfs*/
            <0x0 0x40058000 0x0 0x3000>; /*periphdfs*/
            #clock-cells = <1>;
    };
...
```

## Documentation/devicetree/bindings/crypto/fsl,cse3.yaml
```yaml
# SPDX-License-Identifier: (GPL-2.0-only OR BSD-2-Clause)
%YAML 1.2
---
$id: http://devicetree.org/schemas/serial/fsl,cse3.yaml#
$schema: http://devicetree.org/meta-schemas/core.yaml#

title: Freescale CSE3 Cryptographic Services Engine

description: |
  - Freescale CSE3 Cryptographic Services Engine included in some chips.
    Currently only S32V234 is supported.

allOf:
  - $ref: "rs485.yaml"

properties:
  compatible:
    oneOf:
      - enum:
          - fsl,s32v234-cse3
    description: Should be "fsl,<soc>-cse3"

  reg:
    maxItems: 1
    description: Should contain CSE3 registers location and length

  interrupts:
    maxItems: 1
    description: Should contain CSE3 interrupt number

rs485-rts-active-low: true
linux,rs485-enabled-at-boot-time: true

required:
  - compatible
  - reg
  - interrupts

unevaluatedProperties: false

examples:
  - |
    cse3: crypto@40001000 {
        compatible = "fsl,s32v234-cse3";
        reg = <0x0 0x40001000 0x0 0x1000>;
        interrupts = <0 18 4>;
        status = "disabled";
    };
```

## Documentation/devicetree/bindings/crypto/nxp-hse.yaml
```yaml
# SPDX-License-Identifier: (GPL-2.0-only OR BSD-2-Clause)
%YAML 1.2
---
$id: http://devicetree.org/schemas/crypto/nxp-hse.yaml#
$schema: http://devicetree.org/meta-schemas/core.yaml#

title: NXP Hardware Security Engine

maintainers:
  - Bogdan Folea <bogdan.folea@nxp.com>

description: |
  - NXP Hardware Security Engine is featured on some NXP S32 platforms:
    Crpto offloading support is available on S32G274A, S32G399A and S32R45.

properties:
  compatible:
    oneOf:
      - enum:
          - nxp,s32cc-hse
    description: Standard property. Must include "nxp,s32cc-hse".

  reg:
    maxItems: 2
    description: Standard property. Should specify the physical address and size
                 of MU hardware register space and service descriptor space.

  reg-names:
    maxItems: 2
    description: Standard property. Should specify the names associated with
                 the MU hardware register space and service descriptor space.

  interrupts:
    maxItems: 3
    description: Standard property. Should specify the TX, RX and general
                 purpose interrupt lines used by the respective MU instance.

  interrupt-names:
    maxItems: 3
    description: Standard property. Should specify the names associated with
                 the interrupt lines used by the respective MU instance.

additionalProperties: false

required:
  - compatible
  - reg
  - reg-names
  - interrupts
  - interrupt-names

examples:
  - |
    mu0b@40210000 {
            compatible = "nxp,s32cc-hse";
            reg = <0x40210000 0x1000>,
                  <0x22C00000 0x1000>;
            reg-names = "hse-mu0b-regs",
                        "hse-mu0b-desc";
            interrupts = <0 103 1>,
                         <0 104 1>,
                         <0 105 1>;
            interrupt-names = "hse-mu0b-ack",
                              "hse-mu0b-rx",
                              "hse-mu0b-err";
    };
```

## Documentation/devicetree/bindings/ddr/fsl,s32gen1-ddr.yaml
```yaml
# SPDX-License-Identifier: (GPL-2.0 OR BSD-2-Clause)
%YAML 1.2
---
$id: http://devicetree.org/schemas/watchdog/fsl-s32gen1-ddr.yaml#
$schema: http://devicetree.org/meta-schemas/core.yaml#

title: Freescale DDR Controller ERRATUM 050543

maintainers:
  - Ciprian Marian Costea <ciprianmarian.costea@nxp.com>

allOf:
  - $ref: "ddr.yaml#"

properties:
  compatible:
    enum:
      - fsl,s32gen1-ddr

  reg:
    maxItems: 1

  status:
    enum:
      - enabled
      - disabled

  perf-phandle:
    description: phandle to the "ddr-perf" node

required:
  - compatible
  - reg
  - status
  - perf-phandle

examples:
  - |
    ddr@403C0000 {
        compatible = "fsl,s32gen1-ddr";
        reg = <0x403C0000 0x100>;
        perf-phandle = <&perf>;
        status = "disabled";
    };

...
```

## Documentation/devicetree/bindings/ddr/nxp,s32cc-ddr.yaml
```yaml
# SPDX-License-Identifier: (GPL-2.0 OR BSD-2-Clause)
%YAML 1.2
---
$id: http://devicetree.org/schemas/watchdog/nxp-s32cc-ddr.yaml#
$schema: http://devicetree.org/meta-schemas/core.yaml#

title: Freescale DDR Controller ERRATUM 050543

maintainers:
  - Ciprian Marian Costea <ciprianmarian.costea@nxp.com>

allOf:
  - $ref: "ddr.yaml#"

properties:
  compatible:
    enum:
      - nxp,s32cc-ddr

  reg:
    maxItems: 1

  status:
    enum:
      - enabled
      - disabled

  perf-phandle:
    description: phandle to the "ddr-perf" node

required:
  - compatible
  - reg
  - status
  - perf-phandle

examples:
  - |
    ddr@403C0000 {
        compatible = "nxp,s32cc-ddr";
        reg = <0x403C0000 0x100>;
        perf-phandle = <&perf>;
        status = "disabled";
    };

...
```
