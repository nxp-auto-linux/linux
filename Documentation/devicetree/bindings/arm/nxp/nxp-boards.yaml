## Documentation/devicetree/bindings/mfd/fsl,s32gen1-mc_rgm.yaml
```yaml
# SPDX-License-Identifier: (GPL-2.0 OR BSD-2-Clause)
# Copyright 2021 NXP
%YAML 1.2
---
$id: "http://devicetree.org/schemas/mfd/fsl,s32gen1-mc_rgm.yaml#"
$schema: "http://devicetree.org/meta-schemas/core.yaml#"

title: NXP S32GEN1 MC_RGM regmap device driver

maintainers:
  - Andra-Teodora Ilie <andra.ilie@nxp.com>

description: |
  Device driver that handles proper configuration of MC_RGM
  regmap ranges.

properties:
  compatible:
    items:
      - const: fsl,s32gen1-rgm
      - const: syscon

  reg:
    maxItems: 1

  nxp,syscon-mc-me:
    description: |
      A phandle to MC_ME syscon registers.

required:
  - compatible
  - reg
  - nxp,syscon-mc-me

additionalProperties: false

examples:
  - |
    mc_rgm: mc_rgm@40078000 {
      compatible = "fsl,s32gen1-rgm", "syscon";
      reg = <0x40078000 0x3000>;
      nxp,syscon-mc-me = <&mc_me>;
    };
```

## Documentation/devicetree/bindings/mfd/nxp,s32cc-ddr-gpr.yaml
```yaml
# SPDX-License-Identifier: (GPL-2.0 OR BSD-2-Clause)
# Copyright 2022 NXP
%YAML 1.2
---
$id: "http://devicetree.org/schemas/mfd/nxp,s32cc-ddr-gpr.yaml#"
$schema: "http://devicetree.org/meta-schemas/core.yaml#"

title: NXP S32CC DDR_GPR regmap

maintainers:
  - Andrei Cherechesu <andrei.cherechesu@nxp.com>

description: |
  Device node that handles access by multiple devices to the
  DDR_GPR registers.

properties:
  compatible:
    items:
      - const: nxp,s32cc-ddr-gpr
      - const: syscon

  reg:
    maxItems: 1

required:
  - compatible
  - reg

additionalProperties: false

examples:
  - |
    ddr_gpr: ddr_gpr@4007c600 {
      compatible = "nxp,s32cc-ddr-gpr", "syscon";
      reg = <0x4007c600 0x20>;
    };
```

## Documentation/devicetree/bindings/mfd/nxp,s32g-llce-core.yaml
```yaml
# SPDX-License-Identifier: (GPL-2.0-only or BSD-2-Clause)
%YAML 1.2
---
$id: http://devicetree.org/schemas/mfd/nxp,s32g-llce-core.yaml#
$schema: http://devicetree.org/meta-schemas/core.yaml#

title: NXP LLCE Firmware Loader

maintainers:
  - Ghennadi Procopciuc <ghennadi.procopciuc@nxp.com>

description: |
  The Low Latency Communications Engine (LLCE) controls the traditional automotive
  communication interfaces such as CAN, LIN, FlexRay, and SPI.

  The loader is usually a dependency for the drivers associated with the LLCE accelerator:
    * LLCE mailbox
    * LLCE CAN

properties:
  compatible:
    const: nxp,s32g-llce-core

  firmware-name:
    items:
      - const: dte.bin
      - const: ppe_rx.bin
      - const: ppe_tx.bin
      - const: frpe.bin

  memory-region:
    maxItems: 5
    minItems: 5
    description: |
      A set of phandles to memory regions corresponding to the firmware
      components and a link to the shared memory area used by host and
      LLCE firmware.

  memory-region-names:
    items:
      - const: dte.bin
      - const: ppe_rx.bin
      - const: ppe_tx.bin
      - const: frpe.bin
      - const: shmem

  reg-names:
    const: sysctrl

  reg:
    description:
      Offset and length of the LLCE system control registers

  clock-names:
    const: llce_sys

  clocks:
    description: LLCE system clock

  ranges:
    minItems: 16
    maxItems: 16
    description:
      LLCE FIFOs, LIN and CORE2CORE registers ranges

  '#address-cells':
    const: 2

  '#size-cells':
    const: 2

  '#interrupt-cells':
    const: 3

  interrupt-controller: true

patternProperties:
  '^llce_mb.*':
    type: object

  '^llce_can[0-9]+.*':
    type: object

  '^llce_can_logger[0-9]+.*':
    type: object

  '^llce_uart[0-3]+.*':
    type: object

required:
  - compatible
  - firmware-name
  - memory-region
  - memory-region-names
  - reg-names
  - reg
  - clock-names
  - clocks
  - ranges
  - '#address-cells'
  - '#size-cells'
  - '#interrupt-cells'

additionalProperties: false

examples:
  - |
    #define S32G_SCMI_CLK_LLCE_SYS
    bus {
        #address-cells = <2>;
        #size-cells = <2>;

        llce_core: llce_core@43000000 {
            compatible = "nxp,s32g-llce-core";
            clocks = <&clks S32G_SCMI_CLK_LLCE_SYS>;
            clock-names = "llce_sys";
            firmware-name = "dte.bin", "ppe_rx.bin",
                "ppe_tx.bin", "frpe.bin";
            memory-region = <&llce0_sram>, <&llce1_sram>,
                            <&llce2_sram>, <&llce3_sram>,
                            <&llce_shmem>;
            memory-region-names = "dte.bin", "ppe_rx.bin",
                                  "ppe_tx.bin", "frpe.bin",
                                  "shmem";
            reg = <0x6 0 0x0 0xc>;
            reg-names = "sysctrl";
            /* RX-IN_FIFO */
            ranges = <0x0 0 0x0 0x43A00000 0x0 0x6000>,
                /* RX-OUT_FIFO */
                <0x1 0 0x0 0x43A08000 0x0 0x8000>,
                /* LLCE interrupt Concentrator */
                <0x2 0 0x0 0x43A14000 0x0 0x1000>,
                /* BLR-IN_FIFO */
                <0x3 0 0x0 0x43B00000 0x0 0x6000>,
                /* BLR-OUT_FIFO */
                <0x4 0 0x0 0x43B08000 0x0 0x6000>,
                /* Tx_Ack_FIFO */
                <0x5 0 0x0 0x43B10000 0x0 0x8000>,
                /* LLCE SEMA42*/
                <0x6 0 0x0 0x43c20000 0x0 0x44>,
                /* LLCE UART0 */
                <0x7 0 0x0 0x43c08000 0x0 0x400>,
                /* LLCE UART1 */
                <0x8 0 0x0 0x43c08400 0x0 0x400>,
                /* LLCE UART2 */
                <0x9 0 0x0 0x43c08800 0x0 0x400>,
                /* LLCE UART3 */
                <0x10 0 0x0 0x43c08C00 0x0 0x400>,
                /* LLCE CORE2CORE */
                <0x11 0 0x0 0x43c26000 0x0 0x70>,
                /* LLCE LPSPI0 */
                <0x12 0 0x0 0x43c00000 0x0 0x1000>,
                /* LLCE LPSPI1 */
                <0x13 0 0x0 0x43c01000 0x0 0x1000>,
                /* LLCE LPSPI2 */
                <0x14 0 0x0 0x43c02000 0x0 0x1000>,
                /* LLCE LPSPI3 */
                <0x15 0 0x0 0x43c03000 0x0 0x1000>;
                            #address-cells = <2>;
            #size-cells = <2>;
            #interrupt-cells = <3>;
            status = "okay";
        };
    };
```

## Documentation/devicetree/bindings/misc/fsl,fccu.yaml
```yaml
# SPDX-License-Identifier: (GPL-2.0-only OR BSD-2-Clause)
%YAML 1.2
---
$id: http://devicetree.org/schemas/misc/fsl,fccu.yaml#
$schema: http://devicetree.org/meta-schemas/core.yaml#

title: Fault Collection and Control Unit (FCCU) for S32V234 and S32GEN1

maintainers:
  - Phu Luu An <phu.luuan@nxp.com>

description: |
  This module is used to collect and control fault signals from
  peripherals. It requires a correct configuration to enable reception and react
  to a signal from a channel.

  After it is configured successfully, a reset signal from a configured channel can
  reset the system. If a signal is generated before FCCU is configured, the signal
  will be ignored.

properties:
  compatible:
    enum:
      - fsl,s32v234-fccu
      - fsl,s32gen1-fccu

  nxp,ncf_fault_off:
    description: Array of faults for NCF_Sn registers
    $ref: /schemas/types.yaml#/definitions/uint32-array

  reg:
    description: The address range

  clocks:
    description: Clock access

  clock-names:
    const: fccu

  status:
    enum:
      - enabled
      - disabled

required:
  - compatible
  - nxp,ncf_fault_off
  - reg

additionalProperties: false

examples:
  - |
    #include <dt-bindings/clock/s32v234-clock.h>

    fccu@400B0000 {
      compatible = "fsl,s32v234-fccu";
      reg = <0x400B0000 0x1000>;
      clocks = <&clks S32V234_CLK_SYS6>;
      clock-names = "fccu";
      nxp,ncf_fault_off = <35 36 37 38>;
      status = "disabled";
    };
...
```
