## Documentation/devicetree/bindings/display/fsl,dec200.yaml
```yaml
# SPDX-License-Identifier: (GPL-2.0 OR BSD-2-Clause)
%YAML 1.2
---
$id: http://devicetree.org/schemas/display/fsl,dec200.yaml#
$schema: http://devicetree.org/meta-schemas/core.yaml#

title: Device Tree bindings for Freescale DEC200 Driver

properties:
  compatible:
    oneOf:
      - "fsl,s32v234-dec200_dec"
      - "fsl,s32v234-dec200_enc"

  reg:
    description: Address and length of the register set for dec200.

  clocks:
    description: Handle to "dcu", "sys3" and "sys6" clock.

  clock-names:
    description: Should be "dcu", "sys6" for dec200_dec and
                 "sys3", "sys6" for dec200_enc

required:
  - compatible
  - reg
  - clocks
  - clock-names

examples:
  - |
    dec200_dec: dec200@40026000 {
        compatible = "fsl,s32v234-dec200_dec";
        reg = <0x0 0x40026000 0x0 0x1000>;
        interrupts = <0 97 4>;
        clocks = <&clks S32V234_CLK_DCU_AXI>,
                        <&clks S32V234_CLK_DEC200_ENC_IPS>;
        clock-names = "dcu", "sys6";
        status = "disabled";
    };

    dec200_enc: dec200@40027000 {
        compatible = "fsl,s32v234-dec200_enc";
        reg = <0x0 0x40027000 0x0 0x1000>;
        interrupts = <0 98 4>;
        clocks = <&clks S32V234_CLK_DEC200_ENC_AHB>,
                        <&clks S32V234_CLK_DEC200_ENC_IPS>;
        clock-names = "sys3", "sys6";
        status = "disabled";
    };
```

## Documentation/devicetree/bindings/fb/fsl-fbdcu.yaml
```yaml
# SPDX-License-Identifier: (GPL-2.0-only OR BSD-2-Clause)
# Copyright 2021 NXP.
%YAML 1.2
---
$id: http://devicetree.org/schemas/fb/fsl-fbdcu.yaml#
$schema: http://devicetree.org/meta-schemas/core.yaml#

title: NXP Display Control Unit

maintainers:
  - Ciprian Costea <ciprianmarian.costea@nxp.com>

description: |
  A more detailed multi-line description of the binding.

  Details about the hardware device and any links to datasheets can go here.

  Literal blocks are marked with the '|' at the beginning. The end is marked by
  indentation less than the first line of the literal block. Lines also cannot
  begin with a tab character.

properties:

  compatible:
    const: fsl,s32v234-dcu

  reg:
    description: Address and length of the register set for DCU.

  interrupts:
    description: Should contain DCU interrupts.

  clocks:
    description: From common clock binding - handle to DCU clock.

  clock-names:
    description: From common clock binding - Shall be "dcu".

  memory-region:
    description: The phandle to the reserved memory region.

additionalProperties: false

required:
  - compatible
  - reg
  - interrupts
  - clocks
  - clock-names
  - memory-region

examples:
  - |
    #include <dt-bindings/clock/s32v234-clock.h>

    dcu0: dcu@40028000 {
      compatible = "fsl,s32v234-dcu";
      reg = <0x40028000 0x5000>;
      interrupts = <0 95 4>;
      clocks = <&clks S32V234_CLK_DCU_AXI>,
                <&clks S32V234_CLK_DCU_PIX>;
      clock-names = "dcu", "ipg";
      memory-region = <&dcu_surface_memory>;
      status = "disabled";
    };
```

## Documentation/devicetree/bindings/fb/fsl_fbdcu.txt
```
* Freescale Display Control Unit (DCU)

Required properties:
- compatible: Should be "fsl,s32v234-dcu".
- reg: Address and length of the register set for DCU.
- interrupts: Should contain DCU interrupts.
- clocks: From common clock binding: handle to DCU clock.
- clock-names: From common clock binding: Shall be "dcu".
- memory-region : The phandle to the reserved memory region.

Examples:

#include <dt-bindings/clock/s32v234-clock.h>

dcu0: dcu@40028000 {
	compatible = "fsl,s32v234-dcu";
	reg = <0x40028000 0x5000>;
	interrupts = <0 95 4>;
	clocks = <&clks S32V234_CLK_DCU_AXI>,
		 <&clks S32V234_CLK_DCU_PIX>;
	clock-names = "dcu", "ipg";
	memory-region = <&dcu_surface_memory>;
	status = "disabled";
};
```

## Documentation/devicetree/bindings/gpio/gpio-s32cc.yaml
```yaml
# SPDX-License-Identifier: GPL-2.0-only OR BSD-2-Clause
%YAML 1.2
---
$id: http://devicetree.org/schemas/gpio/gpio-s32cc.yaml#
$schema: http://devicetree.org/meta-schemas/core.yaml#

title: NXP S32CC SIUL2 GPIO controller

maintainers:
  - Ghennadi Procopciuc <Ghennadi.Procopciuc@nxp.com>
  - Larisa Grigore <larisa.grigore@nxp.com>

description: |
  Support for the SIUL2 GPIOs found on the S32CC chips.
  It includes an IRQ controller for all EIRQ pins.

properties:
  compatible:
    items:
      - enum:
          - nxp,s32g-siul2-gpio
          - nxp,s32r-siul2-gpio

  reg:
    maxItems: 6

  reg-names:
    items:
      - const: opads0
      - const: opads1
      - const: ipads0
      - const: ipads1
      - const: eirqs
      - const: eirq-imcrs

  interrupts:
    description:
      Should be the port interrupt shared by all 32 EIRQs

  gpio-controller:
    description:
      Marks the device node as a gpio controller

  "#gpio-cells":
    description: |
      Should be two.  The first cell is the pin number and
      the second cell is used to specify the gpio polarity
      0 = active high
      1 = active low

  interrupt-controller:
    description:
      Marks the device node as an interrupt controller

  "#interrupt-cells":
    const: 2
    description:
      Refer to ../interrupt-controller/interrupts.txt for more details.

  gpio-ranges:
    description:
      Interaction with the PINCTRL subsystem

  eirq-ranges:
    description:
      GPIO ranges that can be used as EIRQs

  gpio-reserved-ranges:
    description:
      A list of start GPIO, number of GPIOs that are invalid if any such.

patternProperties:
  "^(hog-[0-9]+|.+-hog(-[0-9]+)?)$":
    type: object
    properties:
      gpio-hog: true
      gpios: true
      input: true
      output-high: true
      output-low: true
      line-name: true

    required:
      - gpio-hog
      - gpios

required:
  - compatible
  - interrupts
  - reg
  - reg-names
  - gpio-controller
  - "#gpio-cells"
  - interrupt-controller
  - "#interrupt-cells"
  - gpio-ranges

additionalProperties: false

examples:
  - |
    #include <dt-bindings/interrupt-controller/arm-gic.h>
    #include <dt-bindings/interrupt-controller/irq.h>
    #include <dt-bindings/memory/s32cc-siul2.h>

    gpio: siul2-gpio@4009d700 {
      compatible = "nxp,s32g-siul2-gpio";
      reg = <OPADS_SIUL2_0        0x10>,
            <OPADS_SIUL2_1        0x18>,
            <IPADS_SIUL2_0        0x10>,
            <IPADS_SIUL2_1        0x18>,
            <EIRQS_SIUL2_1        0xb4>,
            <IMCRS_SIUL2_1_EIRQS  0x80>;
      reg-names = "opads0", "opads1", "ipads0",
                  "ipads1", "eirqs", "eirq-imcrs";
      gpio-controller;
      #gpio-cells = <2>;
                    /* GPIO 0-101 */
      gpio-ranges = <&pinctrl 0   0   102>,
                    /* GPIO 112-190 */
                    <&pinctrl 112 112 79>;
      gpio-reserved-ranges = <102 10>, <123 21>;
      interrupt-controller;
      #interrupt-cells = <2>;
      interrupts = <GIC_SPI 210 IRQ_TYPE_LEVEL_HIGH>;
      status = "okay";
    };
```

## Documentation/devicetree/bindings/iio/adc/s32-adc.yaml
```yaml
# SPDX-License-Identifier: GPL-2.0
%YAML 1.2
---
$id: http://devicetree.org/schemas/iio/adc/s32-adc.yaml#
$schema: http://devicetree.org/meta-schemas/core.yaml#

title: NXP S32 Analog-to-Digital Converter (SAR-ADC)

maintainers:
  - Ciprian Marian Costea <ciprianmarian.costea@nxp.com>

description: |
  SAR-ADC analog-to-digital converter for S32CC boards

properties:
  compatible:
    enum:
      - nxp,s32cc-adc

  reg:
    maxItems: 1

  interrupts:
    maxItems: 1

  clocks:
    description: SAR-ADC source clock (S32CC_SCMI_CLK_SAR_ADC_BUS)
    maxItems: 1

  clock-names:
    const: adc

  vref:
    description: SAR-ADC reference voltage supply

required:
  - compatible
  - reg
  - interrupts
  - clocks
  - clock-names
  - vref

additionalProperties: false

examples:
  - |
    #define S32CC_SCMI_CLK_SAR_ADC_BUS

    saradc0: adc@401f8000 {
        compatible = "nxp,s32cc-adc";
        reg = <0x401f8000 0x1000>;
        interrupts = <0 70 4>;
        clocks = <&clks S32CC_SCMI_CLK_SAR_ADC_BUS>;
        clock-names = "adc";
        vref = <1800>;
        status = "okay";
    };
```

## Documentation/devicetree/bindings/iio/adc/s32cc-adc.yaml
```yaml
# SPDX-License-Identifier: (GPL-2.0-only OR BSD-2-Clause)
%YAML 1.2
---
$id: http://devicetree.org/schemas/iio/adc/s32-adc.yaml#
$schema: http://devicetree.org/meta-schemas/core.yaml#

title: NXP S32CC Analog-to-Digital Converter (SAR-ADC)

maintainers:
  - Ciprian Marian Costea <ciprianmarian.costea@nxp.com>

description: |
  SAR-ADC analog-to-digital converter for S32CC boards

properties:
  compatible:
    enum:
      - nxp,s32cc-adc

  reg:
    maxItems: 1

  interrupts:
    maxItems: 1

  clocks:
    description: SAR-ADC source clock (S32CC_SCMI_CLK_SAR_ADC_BUS)
    maxItems: 1

  clock-names:
    const: adc

  vref:
    description: SAR-ADC reference voltage supply

required:
  - compatible
  - reg
  - interrupts
  - clocks
  - clock-names
  - vref

additionalProperties: false

examples:
  - |
    adc0: adc@401f8000 {
        compatible = "nxp,s32cc-adc";
        reg = <0x0 0x401f8000 0x0 0x1000>;
        interrupts = <GIC_SPI 70 IRQ_TYPE_LEVEL_HIGH>;
        clocks = <&clks S32GEN1_SCMI_CLK_SAR_ADC_BUS>;
        clock-names = "adc";
        vref = <1800>;
        status = "okay";
    };
```

## Documentation/devicetree/bindings/mailbox/nxp,s32g-llce-mailbox.yaml
```yaml
# SPDX-License-Identifier: (GPL-2.0-only or BSD-2-Clause)
%YAML 1.2
---
$id: http://devicetree.org/schemas/mailbox/nxp,s32g-llce-mailbox.yaml#
$schema: http://devicetree.org/meta-schemas/core.yaml#

title: NXP LLCE Mailbox

maintainers:
  - Ghennadi Procopciuc <ghennadi.procopciuc@nxp.com>

description: |
  This mailbox is present on NXP SoC's where LLCE accelerator is present.
  It facilitates the communication between Linux and LLCE cores.

properties:
  compatible:
    const: nxp,s32g-llce-mailbox

  '#mbox-cells':
    description:
      First number represents the channel type and the second
      represents the ID of the channel.
      Channel types
        * S32G_LLCE_CAN_CONF_MB
        * S32G_LLCE_CAN_LOGGER_MB
        * S32G_LLCE_CAN_LOGGER_CONFIG_MB
        * S32G_LLCE_CAN_RX_MB
        * S32G_LLCE_CAN_TX_MB
    const: 2

  memory-region:
    description:
      A set of phandles to memory regions corresponding to LLCE shared memory region.
    maxItems: 1

  memory-region-names:
    items:
      - const: shmem

  reg-names:
    items:
      - const: rxin_fifo
      - const: rxout_fifo
      - const: icsr
      - const: blrin_fifo
      - const: blrout_fifo
      - const: txack_fifo
      - const: sema42
      - const: core2core
      - const: system_control

  reg:
    items:
      - description: Address and Size of the RXIN fifo memory region
      - description: Address and Size of the RXOUT fifo memory region
      - description: Address and Size of the Interrupt concentrator memory region
      - description: Address and Size of the BLRIN fifo memory region
      - description: Address and Size of the BLROUT fifo memory region
      - description: Address and Size of the TXACK fifo memory region
      - description: Address and Size of the SEMA42 region
      - description: Address and Size of the CORE2CORE region
      - description: Address and Size of the System control memory region

  interrupt-names:
    items:
      - const: lpspi_irq
      - const: linflex_irq
      - const: rxin_fifo_0_7
      - const: rxin_fifo_8_15
      - const: rxout_fifo_0_7
      - const: rxout_fifo_8_15
      - const: txack_fifo_0_7
      - const: txack_fifo_8_15
      - const: logger_rx

  interrupt-controller: true

  '#interrupt-cells':
    const: 1

  interrupts:
    items:
      - description: Shared interrupt line for LPSPI channels
      - description: Shared interrupt line for LIN channels
      - description: Shared interrupt line for RXIN 0-7 fifos
      - description: Shared interrupt line for RXIN 8-15 fifos
      - description: Shared interrupt line for RXOUT 0-7 fifos
      - description: Shared interrupt line for RXOUT 8-15 fifos
      - description: Shared interrupt line for TXACK 0-7 fifos
      - description: Shared interrupt line for TXACK 8-15 fifos
      - description: Interrupt line for LLCE CAN logger

  clock-names:
    const: llce_sys

  clocks:
    description: LLCE system clock

  nxp,hif-id:
    $ref: /schemas/types.yaml#/definitions/uint32
    description:
      The ID of the host interface used during communication with the firmware. 0 will be used
      in case this property is missing.
    enum: [ 0, 1 ]

  nxp,multi-hif:
    description:
      Switch to a multi-host configuration where Linux can configure up to 8 FIFOs.
    type: boolean

required:
  - compatible
  - '#mbox-cells'
  - memory-region
  - reg-names
  - reg
  - interrupt-names
  - interrupt-controller
  - interrupts
  - clock-names
  - clocks

additionalProperties: false

examples:
  - |
    #include <dt-bindings/interrupt-controller/irq.h>
    #define S32G_SCMI_CLK_LLCE_SYS
    bus {
      #address-cells = <2>;
      #size-cells = <2>;

      llce_mb: llce_mb@43a00000 {
        compatible = "nxp,s32g-llce-mailbox";
        #mbox-cells = <2>;

        reg = <0x0 0x0 0x0 0x6000>,
            <0x1 0x0 0x0 0x8000>,
            <0x2 0x0 0x0 0x1000>,
            <0x3 0x0 0x0 0x6000>,
            <0x4 0x0 0x0 0x6000>,
            <0x5 0x0 0x0 0x8000>,
            <0x6 0x0 0x0 0x44>,
            <0x11 0x0 0x0 0x70>,
            <0x16 0x0 0x0 0x20>;
        reg-names = "rxin_fifo",
            "rxout_fifo",
            "icsr",
            "blrin_fifo",
            "blrout_fifo",
            "txack_fifo",
            "sema42",
            "core2core",
            "system_control";
        clocks = <&clks S32G_SCMI_CLK_LLCE_SYS>;
        clock-names = "llce_sys";

        memory-region = <&llce_shmem>;
        memory-region-names = "shmem";
        interrupt-controller;
        #interrupt-cells = <1>;
        interrupts = <0 171 IRQ_TYPE_LEVEL_HIGH>,
            <0 172 IRQ_TYPE_LEVEL_HIGH>,
            <0 174 IRQ_TYPE_LEVEL_HIGH>,
            <0 175 IRQ_TYPE_LEVEL_HIGH>,
            <0 176 IRQ_TYPE_LEVEL_HIGH>,
            <0 177 IRQ_TYPE_LEVEL_HIGH>,
            <0 182 IRQ_TYPE_LEVEL_HIGH>,
            <0 183 IRQ_TYPE_LEVEL_HIGH>,
            <0 184 IRQ_TYPE_LEVEL_HIGH>;
        interrupt-names = "lpspi_irq",
          "linflex_irq",
          "rxin_fifo_0_7",
          "rxin_fifo_8_15",
          "rxout_fifo_0_7",
          "rxout_fifo_8_15",
          "txack_fifo_0_7",
          "txack_fifo_8_15",
          "logger_rx";
        nxp,hif-id = <1>;
        status = "okay";
      };
    };
```

## Documentation/devicetree/bindings/mfd/fsl,s32gen1-mc_me.yaml
```yaml
# SPDX-License-Identifier: (GPL-2.0 OR BSD-2-Clause)
# Copyright 2021 NXP
%YAML 1.2
---
$id: "http://devicetree.org/schemas/mfd/fsl,s32gen1-mc_me.yaml#"
$schema: "http://devicetree.org/meta-schemas/core.yaml#"

title: NXP S32GEN1 MC_ME regmap device driver

maintainers:
  - Andra-Teodora Ilie <andra.ilie@nxp.com>

description: |
  Device driver that handles proper configuration of MC_ME
  regmap ranges.

properties:
  compatible:
    items:
      - const: fsl,s32gen1-mc_me
      - const: syscon

  reg:
    maxItems: 1

required:
  - compatible
  - reg

additionalProperties: false

examples:
  - |
    mc_me: mc_me@40088000 {
      compatible = "fsl,s32gen1-mc_me", "syscon";
      reg = <0x40088000 0x3000>;
    };
```
