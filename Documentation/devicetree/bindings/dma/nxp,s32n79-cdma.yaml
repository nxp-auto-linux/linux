## arch/arm64/configs/s32n7_defconfig
```kconfig
CONFIG_SYSVIPC=y
CONFIG_NO_HZ_IDLE=y
CONFIG_HIGH_RES_TIMERS=y
CONFIG_BPF_SYSCALL=y
CONFIG_BPF_JIT=y
CONFIG_PREEMPT=y
CONFIG_BSD_PROCESS_ACCT=y
CONFIG_BSD_PROCESS_ACCT_V3=y
CONFIG_PSI=y
CONFIG_IKCONFIG=y
CONFIG_IKCONFIG_PROC=y
CONFIG_LOG_BUF_SHIFT=16
CONFIG_CGROUPS=y
CONFIG_CGROUP_SCHED=y
CONFIG_CFS_BANDWIDTH=y
CONFIG_CGROUP_BPF=y
CONFIG_NAMESPACES=y
CONFIG_USER_NS=y
CONFIG_BLK_DEV_INITRD=y
# CONFIG_RD_BZIP2 is not set
# CONFIG_RD_LZMA is not set
# CONFIG_RD_XZ is not set
# CONFIG_RD_LZO is not set
# CONFIG_RD_LZ4 is not set
CONFIG_EXPERT=y
CONFIG_KALLSYMS_ALL=y
CONFIG_PERF_EVENTS=y
CONFIG_ARCH_NXP=y
CONFIG_ARCH_S32=y
# CONFIG_CAVIUM_ERRATUM_22375 is not set
# CONFIG_CAVIUM_ERRATUM_23154 is not set
# CONFIG_CAVIUM_ERRATUM_27456 is not set
# CONFIG_CAVIUM_ERRATUM_30115 is not set
# CONFIG_QCOM_FALKOR_ERRATUM_1003 is not set
# CONFIG_QCOM_FALKOR_ERRATUM_1009 is not set
# CONFIG_QCOM_QDF2400_ERRATUM_0065 is not set
# CONFIG_QCOM_FALKOR_ERRATUM_E1041 is not set
CONFIG_ARM64_VA_BITS_39=y
CONFIG_SCHED_MC=y
CONFIG_SCHED_SMT=y
CONFIG_NR_CPUS=8
CONFIG_COMPAT=y
CONFIG_CMDLINE="console=ttyAMA0"
# CONFIG_EFI is not set
CONFIG_PM_DEBUG=y
CONFIG_JUMP_LABEL=y
CONFIG_MODULES=y
CONFIG_MODULE_UNLOAD=y
CONFIG_BINFMT_MISC=y
# CONFIG_SWAP is not set
# CONFIG_COMPAT_BRK is not set
CONFIG_DEFAULT_MMAP_MIN_ADDR=32768
CONFIG_CMA=y
CONFIG_CMA_DEBUGFS=y
CONFIG_CMA_AREAS=7
CONFIG_NET=y
CONFIG_PACKET=y
CONFIG_SYN_COOKIES=y
CONFIG_BRIDGE=y
CONFIG_BRIDGE_VLAN_FILTERING=y
CONFIG_NET_DSA=y
CONFIG_VLAN_8021Q=y
CONFIG_NET_SCHED=y
CONFIG_NET_SCH_CBS=y
CONFIG_NET_SCH_TAPRIO=y
CONFIG_NET_SCH_MQPRIO=y
CONFIG_NET_SCH_INGRESS=y
CONFIG_NET_CLS_FLOW=y
CONFIG_NET_CLS_FLOWER=y
CONFIG_NET_CLS_ACT=y
CONFIG_NET_ACT_POLICE=y
CONFIG_NET_ACT_MIRRED=y
CONFIG_CAN=y
CONFIG_NET_9P=y
CONFIG_NET_9P_VIRTIO=y
CONFIG_PCI=y
CONFIG_PCI_IOV=y
CONFIG_PCI_HOST_GENERIC=y
CONFIG_DEVTMPFS=y
CONFIG_DEVTMPFS_MOUNT=y
CONFIG_ARM_SCMI_PROTOCOL=y
CONFIG_MTD=y
CONFIG_MTD_SPI_NOR=y
CONFIG_VIRTIO_BLK=y
CONFIG_NXP_CARV_PARTITION=y
CONFIG_SCSI=y
CONFIG_BLK_DEV_SD=y
CONFIG_SCSI_CONSTANTS=y
CONFIG_SCSI_LOGGING=y
CONFIG_SCSI_SCAN_ASYNC=y
CONFIG_NETDEVICES=y
CONFIG_VIRTIO_NET=y
CONFIG_NET_DSA_NETC_SWITCH=y
CONFIG_NXP_ENETC4=y
CONFIG_FSL_ENETC_VF=y
CONFIG_FSL_ENETC_QOS=y
CONFIG_CAN_VCAN=y
CONFIG_CAN_FLEXCAN=y
CONFIG_CAN_SLCAN=y
CONFIG_INPUT_EVDEV=y
# CONFIG_INPUT_MOUSE is not set
CONFIG_INPUT_MISC=y
CONFIG_INPUT_UINPUT=y
CONFIG_SERIO_AMBAKMI=y
CONFIG_VT_HW_CONSOLE_BINDING=y
CONFIG_LEGACY_PTY_COUNT=1
CONFIG_SERIAL_AMBA_PL011=y
CONFIG_SERIAL_AMBA_PL011_CONSOLE=y
CONFIG_SERIAL_FSL_LINFLEXUART=y
CONFIG_SERIAL_FSL_LINFLEXUART_CONSOLE=y
# CONFIG_HW_RANDOM is not set
CONFIG_I2C=y
CONFIG_I2C_CHARDEV=y
CONFIG_I2C_IMX_LPI2C=y
CONFIG_SPI=y
CONFIG_SPI_NXP_XSPI=y
CONFIG_SPI_FSL_DSPI=y
CONFIG_SPI_SPIDEV=y
CONFIG_SPI_SLAVE=y
CONFIG_SPI_SLAVE_TIME=y
CONFIG_SPI_SLAVE_SYSTEM_CONTROL=y
# CONFIG_PTP_1588_CLOCK is not set
CONFIG_WATCHDOG=y
CONFIG_MMC=y
CONFIG_MMC_SDHCI=y
CONFIG_MMC_SDHCI_PLTFM=y
CONFIG_MMC_SDHCI_ESDHC_IMX=y
CONFIG_SCSI_UFSHCD=y
CONFIG_SCSI_UFS_BSG=y
CONFIG_SCSI_UFSHCD_PLATFORM=y
CONFIG_SCSI_UFS_S32N79=y
CONFIG_DMADEVICES=y
CONFIG_FSL_EDMA=y
CONFIG_UIO=y
CONFIG_UIO_NXP_CARV=y
CONFIG_VIRTIO_MMIO=y
CONFIG_STAGING=y
CONFIG_NEUTRON=y
CONFIG_COMMON_CLK_SCMI=y
CONFIG_ARM_SMMU_V3=y
CONFIG_REMOTEPROC=y
CONFIG_REMOTEPROC_CDEV=y
CONFIG_NXP_CARVNET_REMOTEPROC=y
CONFIG_IMX_NEUTRON_REMOTEPROC=y
CONFIG_RPMSG_CHAR=y
CONFIG_RPMSG_CTRL=y
CONFIG_RPMSG_VIRTIO=y
# CONFIG_ARM_SCMI_POWER_DOMAIN is not set
CONFIG_IMX_IRQSTEER=y
CONFIG_PHY_CAN_TRANSCEIVER=y
CONFIG_EXT2_FS=y
CONFIG_EXT2_FS_XATTR=y
CONFIG_EXT2_FS_POSIX_ACL=y
CONFIG_EXT2_FS_SECURITY=y
CONFIG_EXT3_FS=y
CONFIG_EXT3_FS_POSIX_ACL=y
CONFIG_EXT3_FS_SECURITY=y
CONFIG_AUTOFS_FS=y
CONFIG_FUSE_FS=y
CONFIG_VFAT_FS=y
CONFIG_TMPFS=y
CONFIG_TMPFS_POSIX_ACL=y
CONFIG_HUGETLBFS=y
CONFIG_9P_FS=y
CONFIG_NLS_CODEPAGE_437=y
CONFIG_NLS_ISO8859_1=y
CONFIG_LSM="landlock,lockdown,yama,loadpin,safesetid,bpf"
CONFIG_DMA_CMA=y
CONFIG_CMA_SIZE_MBYTES=256
CONFIG_PRINTK_TIME=y
# CONFIG_DEBUG_BUGVERBOSE is not set
CONFIG_DEBUG_INFO_DWARF_TOOLCHAIN_DEFAULT=y
CONFIG_DEBUG_FS=y
# CONFIG_SLUB_DEBUG is not set
# CONFIG_SCHED_DEBUG is not set
# CONFIG_FTRACE is not set
# CONFIG_STRICT_DEVMEM is not set
# CONFIG_RUNTIME_TESTING_MENU is not set
```

## drivers/dma/nxp-cdma/Kconfig
```kconfig
# SPDX-License-Identifier: GPL-2.0 OR BSD-3-Clause

config NXP_CDMA
	tristate "NXP S32N Central DMA (CDMA) Engine"
	depends on PCI && PCI_MSI
	depends on ARM64 || COMPILE_TEST
	depends on HAS_IOMEM
	help
	  Enable support for the NXP S32N79 Central DMA (CDMA) controller.
	  The CDMA is a PCIe Root Complex Integrated Endpoint providing
	  high-bandwidth memory-to-memory, scatter-gather, multicast, and
	  pipe transfer capabilities with zero-copy I/O.

	  The driver exposes char devices (/dev/cdma-pipeN-tx and
	  /dev/cdma-pipeN-rx) for userspace pipe communication. A Linux
	  DMA engine interface for in-kernel consumers may be added in
	  the future.

	  Firmware must pre-configure XRDC, clocks, and IERB registers
	  before Linux boots.
```

## drivers/firmware/arm_scmi/vendors/s32/Kconfig
```kconfig
# SPDX-License-Identifier: GPL-2.0-only
menu "ARM SCMI NXP S32 Vendor Protocols"

config S32_ARM_SCMI_PINCTRL
	bool
	depends on SOC_S32CC
	default y
	help
	  Adds S32 common chassis platforms pinctrl extension over SCMI.

	  Say N if you are unsure.

config S32_ARM_SCMI_NVMEM
	bool
	depends on SOC_S32CC
	default y
	help
	  Adds S32 common chassis platforms nvmem extension over SCMI.

	  Say N if you are unsure.

config S32_ARM_SCMI_GPIO
	bool
	depends on SOC_S32CC
	default y
	help
	  Adds S32 common chassis platforms GPIO extension over SCMI.

	  Say N if you are unsure.

config S32_ARM_SCMI_NXP_DDR
	bool "NXP DDR SCMI Vendor Protocol Extension"
	depends on ARM_SCMI_PROTOCOL || COMPILE_TEST
	help
	  Adds the NXP DDR vendor protocol (0x8B) over SCMI for S32N7-based
	  platforms, providing DDR region discovery and partial DRAM
	  initialization.

	  Say N if unsure.
endmenu
```

## drivers/firmware/s32/Kconfig
```kconfig
# SPDX-License-Identifier: GPL-2.0-only
config S32N_SCMI_MEMORY_HOTPLUG
    bool "S32N SCMI Memory Hotplug Driver"
    depends on MEMORY_HOTPLUG
    depends on S32_ARM_SCMI_NXP_DDR
    help
      Enable support for memory hotplug operations controlled via
      the SCMI NXP DDR vendor protocol extension.

      This driver allows dynamic memory hotplug operations and is
      intended to be used on NXP S32N-based platforms.
```

## drivers/net/can/flexllce/Kconfig
```kconfig
# SPDX-License-Identifier: GPL-2.0 OR BSD-3-Clause
#
# Copyright 2026 NXP
#
config CAN_FLEXLLCE
	tristate "NXP S32N79 FlexLLCE (RCU) CAN support"
	depends on CAN_DEV
	depends on MAILBOX
	depends on ARCH_S32 || COMPILE_TEST
	help
	  Say Y here if you want to use the CAN controllers offloaded to the
	  FlexLLCE firmware running on the Cortex-R52 "RCU" cluster of the NXP
	  S32N79 SoC. The host communicates with the firmware over a
	  shared-memory host interface and the Message Receive Unit (MRU)
	  mailbox controller; the firmware is booted outside Linux (attach-only).

	  This driver exposes each offloaded FlexCAN controller as a standard
	  SocketCAN network device.

	  To compile this driver as a module, choose M here: the module will be
	  called flexllce_can.
```

## drivers/ntb/hw/nxp/Kconfig
```kconfig
# SPDX-License-Identifier: GPL-2.0 OR BSD-3-Clause

config NTB_NXP
	tristate "NXP S32N79 PCIe Non-Transparent Bridge support"
	depends on PCI_MSI
	help
	  Host-side PCIe NTB driver for the NXP S32N79 NTB endpoint function

	  If unsure, say N.
```
