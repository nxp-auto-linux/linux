## Documentation/devicetree/bindings/dma/nxp,s32n79-cdma.yaml
```yaml
# SPDX-License-Identifier: (GPL-2.0-only OR BSD-2-Clause)
%YAML 1.2
---
$id: http://devicetree.org/schemas/dma/nxp,s32n79-cdma.yaml#
$schema: http://devicetree.org/meta-schemas/core.yaml#

title: NXP S32N79 Central DMA (CDMA) Controller

maintainers:
  - Ciprian Marian Costea <ciprianmarian.costea@nxp.com>

description: |
  The Central DMA (CDMA) is a DMA engine in the NXP S32N79 SoC's High-Speed
  Coherent Subsystem (HSCS). It appears as a PCIe Root Complex integrated
  Endpoint (RCiEP) with up to 48 Station Interfaces (SIs), each exposed as a
  separate PCI function using Enhanced Allocation (EA) capability for register
  access.

  Each SI provides up to 16 BD (Buffer Descriptor) rings and supports MSI-X
  interrupts. The CDMA supports memory copy transfers, pipe-based cross-SI
  transfers, scatter/gather, and multicast operations.

  CDMA SIs are enumerated by a generic ECAM PCI host bridge. This binding
  describes the PCI function child nodes under the host bridge for per-SI
  configuration.

properties:
  compatible:
    items:
      - const: pci1131,e200
      - const: nxp,s32n79-cdma

  reg:
    maxItems: 1
    description:
      Standard PCI device address in the parent PCI bus address space.

required:
  - compatible
  - reg

allOf:
  - $ref: /schemas/pci/pci-device.yaml

unevaluatedProperties: false

examples:
  - |
    pcie {
        compatible = "pci-host-ecam-generic";
        reg = <0x3 0x00000000 0x0 0x1800000>;
        #address-cells = <3>;
        #size-cells = <2>;
        device_type = "pci";
        bus-range = <0x0 0x0>;
        dma-coherent;
        ranges = <0x82000000 0x0 0x4d000000
                  0x0 0x4d000000 0x0 0x620000>;

        cdma@0,0 {
            compatible = "pci1131,e200", "nxp,s32n79-cdma";
            reg = <0x0000 0 0 0 0>;
        };
    };
```

## Documentation/devicetree/bindings/firmware/nxp,ddr-scmi.yaml
```yaml
# SPDX-License-Identifier: (GPL-2.0 OR BSD-2-Clause)
%YAML 1.2
---
$id: http://devicetree.org/schemas/firmware/nxp,ddr-scmi.yaml#
$schema: http://devicetree.org/meta-schemas/core.yaml#

title: S32N SCMI NXP DDR Vendor Protocol Extension

maintainers:
  - NXP S32 Linux Team <s32@nxp.com>

properties:
  protocol@8b:
    $ref: '/schemas/firmware/arm,scmi.yaml#/$defs/protocol-node'
    unevaluatedProperties: false

    description:
      NXP DDR protocol node for S32 platforms. This protocol provides
      runtime discovery of the available DDR regions and partial DRAM
      initialization.

    properties:
      reg:
        const: 0x8b

      nxp,ddr-regions:
        $ref: /schemas/types.yaml#/definitions/phandle-array
        minItems: 1
        description: |
          Optional policy list restricting which DDR regions this OS instance
          brings online. Each phandle refers to a memory node:

            - a disabled node is initialized and hot-added;
            - an enabled node is already boot memory and is left alone.

          Omit the property to bring online every region the platform reports.

    required:
      - reg

additionalProperties: false

examples:
  - |
    firmware {
      scmi {
        #address-cells = <1>;
        #size-cells = <0>;

        nxp_ddr: protocol@8b {
          reg = <0x8b>;
        };
      };
    };
```

## Documentation/devicetree/bindings/firmware/nxp,misc-scmi.yaml
```yaml
# SPDX-License-Identifier: (GPL-2.0 OR BSD-2-Clause)
%YAML 1.2
---
$id: http://devicetree.org/schemas/firmware/nxp,misc-scmi.yaml#
$schema: http://devicetree.org/meta-schemas/core.yaml#

title: S32N System Control and Management Interface (SCMI) Vendor Protocols Extension

maintainers:
  - NXP S32 Linux Team <s32@nxp.com>

properties:
  protocol@86:
    $ref: '/schemas/firmware/arm,scmi.yaml#/$defs/protocol-node'
    unevaluatedProperties: false

    description:
      NXP MISC protocol node for S32 platforms. This protocol provides
      DDR partial initialization functionality.

    properties:
      reg:
        const: 0x86

      nxp,ddr-regions:
        $ref: /schemas/types.yaml#/definitions/phandle-array
        minItems: 1
        description:
          List of phandles to reserved memory regions that represent
          DDR areas to be initialized using the SCMI NXP MISC protocol.

    required:
      - reg

additionalProperties: false

examples:
  - |
    ddr_high0: memory@8800000000 {
      device_type = "memory";
      reg = <0x88 0x00000000 0x3 0x40000000>;
      status = "disabled";
    };

    ddr_high1: memory@c000000000 {
      device_type = "memory";
      reg = <0xc0 0x00000000 0x3 0x40000000>;
      status = "disabled";
    };

    firmware {
      scmi {
        #address-cells = <1>;
        #size-cells = <0>;

        nxp_misc: protocol@86 {
          reg = <0x86>;
          nxp,ddr-regions = <&ddr_high0>, <&ddr_high1>;
        };
      };
    };
```

## Documentation/devicetree/bindings/interrupt-controller/nxp,s32n79-mru-msi.yaml
```yaml
# SPDX-License-Identifier: (GPL-2.0-only OR BSD-2-Clause)
%YAML 1.2
---
$id: http://devicetree.org/schemas/interrupt-controller/nxp,s32n79-mru-msi.yaml#
$schema: http://devicetree.org/meta-schemas/core.yaml#

title: NXP S32N79 MRU MSI-X Controller

description:
  The Message Receive Unit (MRU) MSI-X controller provides MSI-X-style
  interrupt support for the S32N79 SoC. It manages multiple MRU instances
  and forwards peripheral MSI-X interrupts as SPI interrupts to the GIC.

maintainers:
  - NXP S32 Linux Team <s32@nxp.com>

allOf:
  - $ref: /schemas/interrupt-controller/msi-controller.yaml#

properties:
  compatible:
    const: nxp,s32n79-mru-msi

  reg:
    minItems: 1
    description:
      Register addresses for each MRU instance. Each entry corresponds
      to the Global Channel (GC) register space.

  interrupts:
    minItems: 1
    description:
      Interrupts for each MRU channel. Each MRU channel has a dedicated
      interrupt line. The number of interrupts must match the number of
      reg entries.

  msi-controller: true

required:
  - compatible
  - reg
  - interrupts
  - msi-controller

additionalProperties: false

examples:
  - |
    #include <dt-bindings/interrupt-controller/arm-gic.h>

    msi-controller@40a00000 {
        compatible = "nxp,s32n79-mru-msi";
        msi-controller;
        reg = <0x40a00000 0x1000>,
              <0x40a40000 0x1000>,
              <0x40a80000 0x1000>,
              <0x40ac0000 0x1000>,
              <0x40b00000 0x1000>,
              <0x40b40000 0x1000>,
              <0x40b80000 0x1000>,
              <0x40bc0000 0x1000>;
        interrupts = <GIC_SPI 704 IRQ_TYPE_LEVEL_HIGH>,
                     <GIC_SPI 705 IRQ_TYPE_LEVEL_HIGH>,
                     <GIC_SPI 706 IRQ_TYPE_LEVEL_HIGH>,
                     <GIC_SPI 707 IRQ_TYPE_LEVEL_HIGH>,
                     <GIC_SPI 708 IRQ_TYPE_LEVEL_HIGH>,
                     <GIC_SPI 709 IRQ_TYPE_LEVEL_HIGH>,
                     <GIC_SPI 710 IRQ_TYPE_LEVEL_HIGH>,
                     <GIC_SPI 711 IRQ_TYPE_LEVEL_HIGH>;
    };
```

## Documentation/devicetree/bindings/mailbox/nxp,s32n79-mru.yaml
```yaml
# SPDX-License-Identifier: GPL-2.0-only OR BSD-2-Clause
%YAML 1.2
---
$id: http://devicetree.org/schemas/mailbox/nxp,s32n79-mru.yaml#
$schema: http://devicetree.org/meta-schemas/core.yaml#

title: NXP S32N79 Message Receive Unit (MRU)

maintainers:
  - Georgiana Ortila <georgiana.ortila@nxp.com>

description: |
  Message Receive Unit (MRU) is a hardware mailbox controller used for
  inter-processor notifications on NXP S32N79 SoCs. Each MRU instance
  exposes multiple hardware channels, each with multiple mailboxes.

  An instance can be instantiated as a sender or as a receiver:
    - The receiver owns and configures the MRU HW and handles the IRQ.
    - The sender only performs doorbell writes to its local MRU registers.

  The role (sender vs receiver) is determined per-channel via the mbox
  specifier.

properties:
  compatible:
    enum:
      - nxp,s32n79-mru
      - nxp,s32n79-rcu-mru

  reg:
    maxItems: 1
    minItems: 1
    description:
      Base address and size of the MRU register space.

  interrupts:
    maxItems: 1
    description:
      Interrupt line for the MRU instance.
      Required only for receiver instances.

  clocks:
    maxItems: 1
    description:
      IPG clock for the APS-visible MRU instance. RCU-owned MRU instances do
      not expose a clock to Linux.

  clock-names:
    items:
      const: ipg

  "#mbox-cells":
    const: 3
    description: |
      Number of cells in the mbox specifier:
        - cell 0: hardware channel (0-2)
        - cell 1: mailbox within the channel (0-5 for nxp,s32n79-mru,
                  0-15 for nxp,s32n79-rcu-mru)
        - cell 2: role (0 = sender, 1 = receiver)

required:
  - compatible
  - reg
  - "#mbox-cells"

allOf:
  - if:
      properties:
        compatible:
          const: nxp,s32n79-mru
    then:
      required:
        - clocks
        - clock-names

additionalProperties: false

examples:
  - |
    #include <dt-bindings/interrupt-controller/arm-gic.h>

    aps0_mru4: mailbox@40b00000 {
        compatible = "nxp,s32n79-mru";
        reg = <0x40b00000 0x40000>;
        interrupts = <GIC_SPI 708 IRQ_TYPE_LEVEL_HIGH>;
        #mbox-cells = <3>;
        clocks = <&clks 0x10a>;
        clock-names = "ipg";
        status = "okay";
    };

    rcu_mru_l1: mailbox@55820000 {
      compatible = "nxp,s32n79-rcu-mru";
      reg = <0x55820000 0x20000>;
      #mbox-cells = <3>;
      status = "okay";
    };
```

## Documentation/devicetree/bindings/misc/nxp,carv-partition.yaml
```yaml
# SPDX-License-Identifier: (GPL-2.0 OR BSD-2-Clause)
%YAML 1.2
---
$id: http://devicetree.org/schemas/misc/nxp,carv-partition.yaml#
$schema: http://devicetree.org/meta-schemas/core.yaml#

title: NXP CAR-V Accelerator

description:
  Binding for NXP CAR-V partition nodes, initially found on NXP S32N7x SoCs,
  which represent isolated execution environments within the CAR-V device.
  CAR-V comprises a grid of many small, interconnected cores running at high
  frequency to allow for a high degree of parallelism.

maintainers:
  - Andrei-Edward Popa <andrei.popa_1@nxp.com>

properties:
  compatible:
    items:
      - const: nxp,carv-partition
      - const: simple-mfd
    description:
      The compatible string for a CAR-V partition within the CAR-V device.
      Uses "simple-mfd" to indicate it can have child nodes.

  reg:
    minItems: 1
    maxItems: 2
    description:
      Base address and size of the CAR-V partition's memory-mapped region.
      If CAR-V partition has N quartiles, it must have N 'reg' entries.

  ranges:
    minItems: 1
    maxItems: 2
    description:
      Address translation mapping for child nodes, defining MMIO region offsets.
      Must correspond to the 2 quartiles in the CAR-V partition.

  '#address-cells':
    const: 1
    description:
      Specifies that child nodes use single address cells.

  '#size-cells':
    const: 1
    description:
      Specifies that child nodes use single size cells.

  nxp,stack-size:
    $ref: /schemas/types.yaml#/definitions/uint32
    enum: [8, 16, 32, 64, 128]
    default: 64
    description:
      Defines the stack size for this CAR-V partition, in KB.

patternProperties:
  "^carv-user@[0-9a-f]+$":
    oneOf:
      - $ref: /schemas/remoteproc/nxp,carvnet-rproc.yaml#
      - $ref: /schemas/misc/nxp,carv-uio.yaml#
    type: object
    description:
      Only one CAR-V remoteproc user within a CAR-V partition is allowed.
      All CAR-V users can bind the CAR-V UIO driver within a CAR-V partition.
    properties:
      compatible:
        oneOf:
          - enum:
              - nxp,carvnet-rproc
              - nxp,carv-uio
    additionalProperties: true

required:
  - compatible
  - reg
  - ranges

additionalProperties: false

examples:
  - |
    #include <dt-bindings/interrupt-controller/arm-gic.h>

    /* Setup for a partition consisting of 1 quartile and 4 UIO users. */
    carv-partition@47800000 {
        compatible = "nxp,carv-partition", "simple-mfd";
        reg = <0x47800000 0x10000>;
        ranges = <0x47800000 0x47800000 0x50000>;
        #address-cells = <1>;
        #size-cells = <1>;
        status = "okay";

        nxp,stack-size = <8>;

        carv-user@47810000 {
            compatible = "nxp,carv-uio";
            reg = <0x47810000 0x10000>;
            interrupts = <GIC_SPI 251 IRQ_TYPE_LEVEL_HIGH>;
            status = "okay";
        };

        carv-user@47820000 {
            compatible = "nxp,carv-uio";
            reg = <0x47820000 0x10000>;
            interrupts = <GIC_SPI 253 IRQ_TYPE_LEVEL_HIGH>;
            status = "okay";
        };

        carv-user@47830000 {
            compatible = "nxp,carv-uio";
            reg = <0x47830000 0x10000>;
            interrupts = <GIC_SPI 255 IRQ_TYPE_LEVEL_HIGH>;
            status = "okay";
        };

        carv-user@47840000 {
            compatible = "nxp,carv-uio";
            reg = <0x47840000 0x10000>;
            interrupts = <GIC_SPI 257 IRQ_TYPE_LEVEL_HIGH>;
            status = "okay";
        };
    };

    /* Setup for a partition consisting of 1 quartile and 4 UIO users. */
    carv-partition@47850000 {
        compatible = "nxp,carv-partition", "simple-mfd";
        reg = <0x47850000 0x10000>;
        ranges = <0x47500000 0x47850000 0x50000>;
        #address-cells = <1>;
        #size-cells = <1>;
        status = "okay";

        carv-user@47860000 {
            compatible = "nxp,carv-uio";
            reg = <0x47860000 0x10000>;
            interrupts = <GIC_SPI 259 IRQ_TYPE_LEVEL_HIGH>;
            status = "okay";
        };

        carv-user@47870000 {
            compatible = "nxp,carv-uio";
            reg = <0x47870000 0x10000>;
            interrupts = <GIC_SPI 261 IRQ_TYPE_LEVEL_HIGH>;
            status = "okay";
        };

        carv-user@47880000 {
            compatible = "nxp,carv-uio";
            reg = <0x47880000 0x10000>;
            interrupts = <GIC_SPI 263 IRQ_TYPE_LEVEL_HIGH>;
            status = "okay";
        };

        carv-user@47890000 {
            compatible = "nxp,carv-uio";
            reg = <0x47890000 0x10000>;
            interrupts = <GIC_SPI 265 IRQ_TYPE_LEVEL_HIGH>;
            status = "okay";
        };
    };
  - |
    #include <dt-bindings/interrupt-controller/arm-gic.h>

    /* Setup for a partition consisting of 2 quartiles and 4 UIO users. */
    carv-partition@47800000 {
        compatible = "nxp,carv-partition", "simple-mfd";
        reg = <0x47800000 0x10000>,<0x47850000 0x10000>;
        ranges = <0x47800000 0x47800000 0x50000>,
                 <0x47850000 0x47850000 0x50000>;
        #address-cells = <1>;
        #size-cells = <1>;
        status = "okay";

        nxp,stack-size = <32>;

        carv-user@47810000 {
            compatible = "nxp,carv-uio";
            reg = <0x47810000 0x10000>,<0x47860000 0x10000>;
            interrupts = <GIC_SPI 251 IRQ_TYPE_LEVEL_HIGH>;
            status = "okay";
        };

        carv-user@47820000 {
            compatible = "nxp,carv-uio";
            reg = <0x47820000 0x10000>,<0x47870000 0x10000>;
            interrupts = <GIC_SPI 253 IRQ_TYPE_LEVEL_HIGH>;
            status = "okay";
        };

        carv-user@47830000 {
            compatible = "nxp,carv-uio";
            reg = <0x47830000 0x10000>,<0x47880000 0x10000>;
            interrupts = <GIC_SPI 255 IRQ_TYPE_LEVEL_HIGH>;
            status = "okay";
        };

        carv-user@47840000 {
            compatible = "nxp,carv-uio";
            reg = <0x47840000 0x10000>,<0x47890000 0x10000>;
            interrupts = <GIC_SPI 257 IRQ_TYPE_LEVEL_HIGH>;
            status = "okay";
        };
    };
```
