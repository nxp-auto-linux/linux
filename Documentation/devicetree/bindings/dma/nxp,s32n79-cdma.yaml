## Documentation/devicetree/bindings/pci/nxp,s32n79-pcie.yaml
```yaml
# SPDX-License-Identifier: (GPL-2.0-only OR BSD-2-Clause)
%YAML 1.2
---
$id: http://devicetree.org/schemas/pci/nxp,s32n79-pcie.yaml#
$schema: http://devicetree.org/meta-schemas/core.yaml#

title: NXP S32N79 PCIe Root Complex controller

maintainers:
  - Valentin Ciocoi Radulescu <valentin.ciocoi@nxp.com>

description: |
  This PCIe controller is based on the Synopsys DesignWare PCIe IP.
  The S32N79 SoC has up to four PCIe controllers, which can be configured
  as either Root Complex or Endpoint.

properties:
  compatible:
    const: nxp,s32n79-pcie

  reg:
    maxItems: 4

  reg-names:
    items:
      - const: dbi
      - const: atu
      - const: config
      - const: pcm

  interrupts:
    maxItems: 1

  interrupt-names:
    items:
      - const: misc

  msi-parent:
    description: |
      Use this option to reference the GIC controller node which will
      handle the MSIs. This property can be used only in Root Complex mode.
      The msi-parent node must be declared as "msi-controller".
      If "msi-parent" is not present in the PCIe node, MSIs will be handled
      by iMSI-RX -Integrated MSI Receiver [AXI Bridge]-, an integrated
      MSI reception module in the PCIe controller's AXI Bridge which
      detects and terminates inbound MSI requests (received on the RX wire).
      These MSIs no longer appear on the AXI bus, instead a hard-wired
      interrupt is raised, documented as "DSP AXI MSI Interrupt" in the SoC
      Reference Manual.

  nxp,coherency-boundary:
    $ref: /schemas/types.yaml#/definitions/uint64
    description: |
      Physical address boundary that separates coherent memory space from
      non-coherent peripheral space. The PCIe controller uses this boundary
      to determine coherency handling for transactions.

      Addresses above this boundary are treated as coherent memory, while
      addresses below are treated as non-coherent peripheral space.

      Typically set to the base address of DDR as seen by the system.

required:
  - compatible
  - reg
  - reg-names
  - ranges
  - msi-parent
  - msi-map
  - interrupts
  - interrupt-names
  - nxp,coherency-boundary

allOf:
  - $ref: /schemas/pci/snps,dw-pcie.yaml#

unevaluatedProperties: false

examples:
  - |
    #include <dt-bindings/interrupt-controller/arm-gic.h>
    bus {
        #address-cells = <2>;
        #size-cells = <2>;

        pcie2: pcie@4c800000 {
            compatible = "nxp,s32n79-pcie";
            device_type = "pci";
            nxp,coherency-boundary = <0x0 0x80000000>;
            #interrupt-cells = <1>;
            #address-cells = <3>;
            #size-cells = <2>;

            reg = <0x00 0x4c800000 0x0 0x00001000>,
                  <0x00 0x4c910000 0x0 0x00020000>,
                  <0x00 0x6Bffe000 0x0 0x00002000>,
                  <0x00 0x4ba80000 0x0 0x00001000>;
            reg-names = "dbi", "atu", "config", "pcm";
            ranges = /* 65528KB outbound mem (64MB - 8KB config region) */
                     <0x02000000 0x0 0x00000000 0x0 0x68000000 0x0 0x3ffe000>,
                     /* 32GB outbound mem */
                     <0x03000000 0x1 0x00000000 0x50 0x00000000 0x8 0x00000000>;

            bus-range = <0x0 0xff>;

            msi-parent = <&its>;
            msi-map = <0x0 &its 0x30000 0x10000>;
            interrupt-map-mask = <0 0 0 0x7>;
            interrupt-map = <0 0 0 1 &gic 0 GIC_SPI 502 IRQ_TYPE_LEVEL_HIGH>,
                            <0 0 0 2 &gic 0 GIC_SPI 503 IRQ_TYPE_LEVEL_HIGH>,
                            <0 0 0 3 &gic 0 GIC_SPI 504 IRQ_TYPE_LEVEL_HIGH>,
                            <0 0 0 4 &gic 0 GIC_SPI 505 IRQ_TYPE_LEVEL_HIGH>;
            interrupts = <GIC_SPI 507 IRQ_TYPE_LEVEL_HIGH>;
            interrupt-names = "misc";

            num-lanes = <2>;
            max-link-speed = <4>;
        };
    };
```

## Documentation/devicetree/bindings/remoteproc/nxp,carvnet-rproc.yaml
```yaml
# SPDX-License-Identifier: (GPL-2.0 OR BSD-2-Clause)
%YAML 1.2
---
$id: http://devicetree.org/schemas/remoteproc/nxp,carvnet-rproc.yaml#
$schema: http://devicetree.org/meta-schemas/core.yaml#

title: NXP CAR-V Accelerator

description:
  This binding provides support for CAR-V, initially found on NXP S32N7x SoCs.
  The CAR-V (Coherent-mesh Acceleration RISC-V) comprises a grid of many small,
  interconnected Cores running at high frequency to allow for a high degree
  of parallelism.
  The CAR-V-NET mode implements networking acceleration and custom processing
  support for companion ENETC Ethernet controller.

maintainers:
  - Jan Petrous <jan.petrous@nxp.com>

properties:
  compatible:
    enum:
      - nxp,carvnet-rproc

  reg:
    description:
      Address ranges of the CAR-V system interface registers for each
      quartile within the CAR-V partition. Each CAR-V partition is
      interfaced by separate instance of the nxp_carvnet_rproc kernel
      driver. If partition contains two quartiles, there are 2 address
      ranges in this reg list, otherwise there is only 1 address range.
    minItems: 1
    maxItems: 2

  memory-region:
    description:
      A phandle for a reserved memory areas that are used for vdev buffers,
      firmware used by remote processor or user regions. There are 4 priority
      regions, first one occupied by the 3 virtio carveouts (vring0/vring1/vdev)
      and the other 3 available for user-defined regions.
    minItems: 1
    maxItems: 6

  memory-region-names:
    maxItems: 6

  firmware-name:
    description:
      Default name of the firmware to load to the CAR-V processor.

  interrupts:
    minItems: 1
    maxItems: 1

  nxp,s32n7-carv-mem-region-types:
    $ref: /schemas/types.yaml#/definitions/uint32-array
    description:
      Type of the CarV memory used as attribute of the BAR register
    minItems: 1
    maxItems: 6

required:
  - compatible
  - reg
  - memory-region
  - memory-region-names
  - firmware-name
  - interrupts
  - nxp,s32n7-carv-mem-region-types

additionalProperties: false

examples:
  - |
    #include <dt-bindings/interrupt-controller/arm-gic.h>
    #include <dt-bindings/memory/s32n7-carv.h>

    /* A setup using one Quartile */
    carv-user@47810000 {
      compatible = "nxp,carvnet-rproc";
      reg = <0x47810000 0x10000>;
      interrupts = <GIC_SPI 279 IRQ_TYPE_LEVEL_HIGH>;
      status = "okay";
      firmware-name = "s32n7-carvnet.fw";
      memory-region = <&carv0_reserved>, <&carv0_vdev0vring0>,
          <&carv0_vdev0vring1>, <&carv0_vdev0buffer>, <&carv0_packet_sram>;
      memory-region-names = "carv-reserved","vdev0vring0",
          "vdev0vring1","vdev0buffer","packet-sram";
      nxp,s32n7-carv-mem-region-types = <CARV_MEM_NONCOHERENT>,<CARV_MEM_NONCOHERENT>,
          <CARV_MEM_NONCOHERENT>,<CARV_MEM_NONCOHERENT>,<CARV_MEM_SHARED>;
    };
  - |
    #include <dt-bindings/interrupt-controller/arm-gic.h>
    #include <dt-bindings/memory/s32n7-carv.h>

    /* A setup using two Quartiles */
    carv-user@47810000 {
      compatible = "nxp,carvnet-rproc";
      reg = <0x47810000 0x10000>,<0x47860000 0x10000>;
      interrupts = <GIC_SPI 279 IRQ_TYPE_LEVEL_HIGH>;
      status = "okay";
      firmware-name = "s32n7-carvnet.fw";
      memory-region = <&carv0_reserved>, <&carv0_vdev0vring0>,
          <&carv0_vdev0vring1>, <&carv0_vdev0buffer>, <&carv0_packet_sram>;
      memory-region-names = "carv-reserved","vdev0vring0",
          "vdev0vring1","vdev0buffer","packet-sram";
      nxp,s32n7-carv-mem-region-types = <CARV_MEM_NONCOHERENT>,<CARV_MEM_NONCOHERENT>,
          <CARV_MEM_NONCOHERENT>,<CARV_MEM_NONCOHERENT>,<CARV_MEM_SHARED>;
    };
```

## Documentation/devicetree/bindings/remoteproc/nxp,neutron-rproc.yaml
```yaml
# SPDX-License-Identifier: (GPL-2.0 OR BSD-2-Clause)
%YAML 1.2
---
$id: http://devicetree.org/schemas/remoteproc/nxp,neutron-rproc.yaml#
$schema: http://devicetree.org/meta-schemas/core.yaml#

title: NXP Neutron Accelerator

description:
  This binding provides support for Neutron, initially found on NXP S32N7x and
  i.MX95 SoCs.

maintainers:
  - Alexandru Iulian Taran <alexandru.taran@nxp.com>

properties:
  compatible:
    enum:
      - fsl,imx95-neutron-rproc
      - nxp,s32n7-neutron-rproc

  reg:
    description:
      Address ranges of the Neutron reset and control(RESETCTRL) register.
    maxItems: 1

required:
  - compatible
  - reg

additionalProperties: false

examples:
  - |
    bus {
        #address-cells = <2>;
        #size-cells = <2>;
        remoteproc@25f80000 {
            compatible = "nxp,s32n7-neutron-rproc";
            reg = <0x0 0x25f80000 0x0 0x4>;
        };
    };
  - |
    bus {
        #address-cells = <2>;
        #size-cells = <2>;
        remoteproc@4ab00000 {
            compatible = "fsl,imx95-neutron-rproc";
            reg = <0x0 0x4ab00000 0x0 0x4>;
        };
    };
```

## Documentation/devicetree/bindings/reserved-memory/nxp,s32g-pfe-pool.yaml
```yaml
# SPDX-License-Identifier: (GPL-2.0-only OR BSD-2-Clause)
%YAML 1.2
---
$id: http://devicetree.org/schemas/reserved-memory/nxp,s32g-pfe-pool.yaml#
$schema: http://devicetree.org/meta-schemas/core.yaml#

title: NXP S32G PFE Reserved Memory Pools

maintainers:
  - Khristine Andreea Barbulescu <khristineandreea.barbulescu@nxp.com>

description: |
  Reserved memory regions used by the Packet Forwarding Engine (PFE) found on
  NXP S32G SoCs. The PFE requires dedicated, physically contiguous memory pools
  for its internal buffers:
    - the BMU2 buffer pool,
    - the routing table (RT) pool,
    - the buffer descriptor ring (BDR) pool.
  Each pool is described as a child node of the /reserved-memory node.

properties:
  compatible:
    enum:
      - nxp,s32g-pfe-bmu2-pool
      - nxp,s32g-pfe-rt-pool
      - nxp,s32g-pfe-bdr-pool
    description: |
      Identifies the PFE memory pool:
        "nxp,s32g-pfe-bmu2-pool" - Buffer Management Unit 2 pool.
        "nxp,s32g-pfe-rt-pool"   - Routing table pool.
        "nxp,s32g-pfe-bdr-pool"  - Buffer descriptor ring pool.

  reg:
    description: Standard property. Physical address and size of the reserved
                 memory region.

  no-map:
    $ref: /schemas/types.yaml#/definitions/flag
    description:
      Avoid creating a virtual mapping of the region as part of the OS'
      standard mapping of system memory.

additionalProperties: false

required:
  - compatible
  - reg

examples:
  - |
    reserved-memory {
        #address-cells = <2>;
        #size-cells = <2>;

        pfebufs@34000000 {
            compatible = "nxp,s32g-pfe-bmu2-pool";
            reg = <0x0 0x34000000 0x0 0x80000>;
            no-map;
        };

        pfebufs@34080000 {
            compatible = "nxp,s32g-pfe-rt-pool";
            reg = <0x0 0x34080000 0x0 0x20000>;
            no-map;
        };

        pfebufs@835e0000 {
            compatible = "nxp,s32g-pfe-bdr-pool";
            reg = <0x0 0x835e0000 0x0 0x20000>;
        };
    };
```

## Documentation/devicetree/bindings/ufs/nxp,s32n79-ufshc.yaml
```yaml
# SPDX-License-Identifier: GPL-2.0-only OR BSD-2-Clause
%YAML 1.2
---
$id: http://devicetree.org/schemas/ufs/nxp,s32n79-ufshc.yaml#
$schema: http://devicetree.org/meta-schemas/core.yaml#

title: NXP S32N79 Universal Flash Storage (UFS) Controller

maintainers:
  - Larisa Grigore <larisa.grigore@nxp.com>

# Select only our matches, not all jedec,ufs
select:
  properties:
    compatible:
      contains:
        enum:
          - nxp,s32n79-ufshc
          - nxp,s32n79-ufshc-virt
  required:
    - compatible

allOf:
  - $ref: ufs-common.yaml
  - if:
      not:
        required:
          - dma-coherent
    then:
      required:
        - memory-region

properties:
  compatible:
    items:
      - enum:
          - nxp,s32n79-ufshc
          - nxp,s32n79-ufshc-virt
      - const: jedec,ufs-3.0

  reg:
    minItems: 1
    items:
      - description: UFS Host Controller registers
      - description: System Control Module registers

  reg-names:
    description: |
      Names for the register regions. The first entry must be "ufshc".
      The second entry "scm" is mandatory only when nxp,mphy-boot-mode
      property is present.
    minItems: 1
    items:
      - const: ufshc
      - const: scm

  clocks:
    maxItems: 1
    description: UFS core clock

  clock-names:
    items:
      - const: core_clk

  memory-region:
    maxItems: 1
    description:
      Reserved DMA pool used for UFS coherent descriptor allocations when the
      UFS controller is not DMA coherent. Required on S32N79 platforms as a
      workaround for ERR053438.

  nxp,mphy-boot-mode:
    description: |
      MPHY initialization mode. Defines how the MPHY firmware should be
      initialized and executed during UFS controller startup.
      If this property is not specified, MPHY initialization will be skipped.
    $ref: /schemas/types.yaml#/definitions/string
    oneOf:
      - const: rom
        description: |
          Execute MPHY firmware directly from the internal ROM. The controller
          will use the factory-programmed firmware stored in the internal ROM
          without any modifications.
      - const: copy-sram
        description: |
          Copy MPHY firmware from ROM to external SRAM and execute from there.
          This mode allows for firmware modifications to be applied to the SRAM
          copy before execution.

  dma-coherent: true

  iommus:
    maxItems: 1

required:
  - compatible
  - reg

unevaluatedProperties: false

examples:
  - |
    ufshc@4ac80000 {
        compatible = "nxp,s32n79-ufshc", "jedec,ufs-3.0";
        reg = <0x4ac80000 0x1000>, <0x4ac40000 0x1000>;
        reg-names = "ufshc", "scm";
        interrupt-parent = <&irqsteer0_coss>;
        interrupts = <211>;
        clocks = <&sys_clk>;
        clock-names = "core_clk";
        iommus = <&smmu 0x100>;
        dma-coherent;
    };

  - |
    reserved-memory {
        #address-cells = <1>;
        #size-cells = <1>;

        dma_pool: dma-pool@80000000 {
            compatible = "shared-dma-pool";
            reg = <0x80000000 0x80000>;
            no-map;
        };
    };

    ufshc@4ac80000 {
        compatible = "nxp,s32n79-ufshc", "jedec,ufs-3.0";
        reg = <0x4ac80000 0x1000>, <0x4ac40000 0x1000>;
        reg-names = "ufshc", "scm";
        interrupt-parent = <&irqsteer0_coss>;
        interrupts = <211>;
        clocks = <&sys_clk>;
        clock-names = "core_clk";
        memory-region = <&dma_pool>;
    };
```
