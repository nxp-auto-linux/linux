// SPDX-License-Identifier: GPL-2.0-or-later OR MIT
/*
 * Device Tree file for S32G399ARDB3 Board Rev E.
 *
 * Copyright 2022-2023 NXP
 */

/dts-v1/;

#include "s32g3.dtsi"
#include "s32gxxxa-rdb.dtsi"

/ {
	model = "NXP S32G3 Reference Design Board (S32G-VNP-RDB3)";
	compatible = "nxp,s32g399a-rdb3", "nxp,s32g3";
};

/* UART (J2) to Micro USB port */
&uart0 {
	status = "okay";
};

/* UART (J1) to Micro USB port */
&uart1 {
	status = "okay";
};
