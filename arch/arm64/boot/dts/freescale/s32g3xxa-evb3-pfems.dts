// SPDX-License-Identifier: GPL-2.0-or-later
/*
 * Copyright 2022 NXP
 */

#include "s32g3xxa-evb3.dtsi"
#include "s32g-pfe-slave.dtsi"

&pfe_aux0 {
	status = "okay";
};

&pfesl_aux0 {
	status = "okay";
};
