// SPDX-License-Identifier: GPL-2.0-or-later
/*
 * Device Tree file for S32G399ARDB3 Board Rev E - CDMA cross-SoC pipe 10.
 *
 * Flashed on both S32G boards participating in the cross-SoC test.
 * Each board exchanges data with the other via N79's CDMA pipe matcher.
 * Data path:
 *   S32G RAM <-> PCIe <-> N79 SI X (BD ring) <-> internal pipe match
 *   <-> N79 SI Y (BD ring) <-> PCIe <-> S32G RAM.
 *
 * Authorised pipe pair (per N79's IERB PID10AUR=0x0544):
 * SI 4 <-> SI 21. Both endpoints set nxp,pipe-id = <10>.
 *
 * Copyright 2026 NXP
 */

#include "s32g399a-rdb3.dtsi"

&pcie0 {
	/*
	 * EP is on bus 1, downstream of the host bridge at 00:00.0. The
	 * intermediate pcie@0,0 node declares that synthetic bridge so
	 * the PCI/OF matcher can attach an of_node to it and propagate
	 * it down to bus 1; without the bridge node, the EP would never
	 * get its of_node set and nxp,pipe-id would be unreachable.
	 *
	 * reg cell encodes the BDF as:
	 *   phys.hi = (bus<<16) | (dev<<11) | (fn<<8)
	 */
	pcie@0,0 {
		reg = <0x0000 0 0 0 0>;
		#address-cells = <3>;
		#size-cells = <2>;
		bus-range = <0x01 0x01>;
		ranges;
		device_type = "pci";

		cdma_pipe10: cdma@0,2 {
			reg = <0x00010200 0 0 0 0>;
			nxp,pipe-id = <10>;
		};
	};
};
