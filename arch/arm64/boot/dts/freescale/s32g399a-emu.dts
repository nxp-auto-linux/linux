// SPDX-License-Identifier: GPL-2.0-or-later OR MIT
/*
 * Copyright 2021-2023 NXP
 */

/dts-v1/;
#include "s32g3.dtsi"

/ {
	model = "Emulator for NXP S32G399A";

	chosen {
		stdout-path = "serial1:115200n8";
	};
};

&timer {
	clock-frequency = <5000000>;
};

&usdhc0 {
	pinctrl-names = "default", "state_100mhz", "state_200mhz";
	pinctrl-0 = <&sd0_pins_default>;
	pinctrl-1 = <&sd0_pins_100mhz>;
	pinctrl-2 = <&sd0_pins_200mhz>;
	no-1-8-v;
	status = "okay";
};
