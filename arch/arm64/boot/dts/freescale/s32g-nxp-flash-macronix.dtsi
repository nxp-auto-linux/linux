// SPDX-License-Identifier: (GPL-2.0+ OR BSD-3-Clause)
/*
 * Copyright 2022-2024 NXP
 */

#include "s32cc-nxp-flash-macronix.dtsi"

&macronix_memory {
	partitions {
		pfe@32c0000 {
			label = "PFE-Firmware";
			reg = <0x32c0000 0xd40000>;
		};
	};
};
