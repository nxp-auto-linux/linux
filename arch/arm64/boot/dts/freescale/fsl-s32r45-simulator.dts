/*
 * Copyright 2017 NXP
 *
 * This program is free software; you can redistribute it and/or modify
 * it under the terms of the GNU General Public License as published by
 * the Free Software Foundation; either version 2 of the License, or
 * (at your option) any later version.
 */

/dts-v1/;
#include "fsl-s32r45.dtsi"
/ {
	chosen {
		linux,initrd-start = <0xa0000000>;
		linux,initrd-end = <0xa2000000>;

	};
};
