// SPDX-License-Identifier: GPL-2.0-or-later OR MIT
/*
 * Device Tree file for S32R45EVB Board.
 *
 * Copyright 2019-2022 NXP
 */

/dts-v1/;
#include "s32r45.dtsi"

/ {
	model = "NXP S32R458-EVB";
};
